## zephyr/Kconfig.led_dt
```kconfig
# Copyright 2022 The ChromiumOS Authors
# Use of this source code is governed by a BSD-style license that can be
# found in the LICENSE file.

menuconfig PLATFORM_EC_LED_DT
	bool "DT LED Support"
	default y
	depends on DT_HAS_CROS_EC_LED_POLICY_ENABLED
	help
	  Enable devicetree based LED module supporting automatic control of the
	  battery and power LEDs.

if PLATFORM_EC_LED_DT

config PLATFORM_EC_LED_DT_GPIO
	bool "DT LED Support (GPIO)"
	default y
	depends on DT_HAS_CROS_EC_GPIO_LED_PINS_ENABLED
	help
	  Enable support for devicetree GPIO LEDs, requires a node using the
	  cros-ec,gpio-led-pins compatible.

config PLATFORM_EC_LED_DT_PWM
	bool "DT LED Support (PWM)"
	default y
	depends on DT_HAS_CROS_EC_PWM_LED_PINS_ENABLED
	select PWM
	help
	  Enable support for devicetree PWM LEDs, requires a node using the
          cros-ec,pwm-led-pins compatible.

config PLATFORM_EC_LED_DT_LIGHTBAR
	bool "DT Lightbar LED driver"
	default y
	depends on DT_HAS_CROS_EC_LED_LIGHTBAR_ENABLED
	select LED_STRIP
	select NANOPB
	select NANOPB_NO_ERRMSG
	select NANOPB_BUFFER_ONLY
	select NANOPB_WITHOUT_64BIT
	help
	  Enable support for devicetree Lightbar LEDs, requires a node using the
	  cros-ec,led-lightbar compatible.

config PLATFORM_EC_LB_CONSOLE_CMD
	bool "Lightbar console command"
	default y
	depends on SHELL && PLATFORM_EC_LED_DT_LIGHTBAR
	help
	  Enable console commands for the lightbar.

config PLATFORM_EC_CBI_UFSC_LIGHTBAR
	bool "Select Lightbar Golden Color Set via CBI UFSC"
	default y if DT_HAS_CROS_EC_CBI_UFSC_LIGHTBAR_SELECTOR_ENABLED
	depends on PLATFORM_EC_LED_DT_LIGHTBAR
	depends on CROS_EC_CBI_UFSC_PARSER
	help
	  Enables generic logic to select the lightbar golden color set
	  based on UFSC data defined in a node with the
	  'cros-ec,cbi-ufsc-lightbar-selector' compatible string.

config PLATFORM_EC_LIGHTBAR_ANIMATION_EXTRA_HOLD_MS
	int "Lightbar animation extra hold time (ms) [DEPRECATED]"
	default 0
	depends on PLATFORM_EC_LED_DT_LIGHTBAR
	help
	  [DEPRECATED] Specifies the additional duration (in milliseconds) to
	  hold the final state of a one-shot lightbar animation beyond the
	  standard 50ms baseline before allowing a transition to the next state.
	  Default is 0 (uses standard 50ms hold). Only available on legacy
	  projects (meru, mica, quartz, annite, pic, aneto); do not use on new
	  projects.

config PLATFORM_EC_LIGHTBAR_AC_UNPLUG_DELAY_MS
	int "AC unplug animation start delay (ms) [DEPRECATED]"
	default 0
	depends on PLATFORM_EC_LED_DT_LIGHTBAR
	help
	  [DEPRECATED] Specifies a configurable delay (in milliseconds) to wait
	  after an AC unplug event is detected before triggering the unplug
	  animation.
	  Set to 0 to trigger the animation instantly (default). When 0, all
	  delay timer logic and callback code are compiled out to save flash
	  and RAM. Only available on legacy projects (meru, mica, quartz, annite,
	  pic, aneto); do not use on new projects.

endif
```

## zephyr/dts/bindings/fingerprint/focaltech,ft9849.yaml
```yaml
# Copyright 2026 The Chromium OS Authors. All rights reserved.
# Use of this source code is governed by a BSD-style license that can be
# found in the LICENSE file.

description: FT9849 fingerprint sensor

compatible: "focaltech,ft9849"

include: [spi-device.yaml]

properties:
  irq-gpios:
    type: phandle-array
    required: true
    description: |
      This property specifies the connection for sensor interrupt.

  reset-gpios:
    type: phandle-array
    required: true
    description: |
      This property specifies the connection for sensor reset.
```

## zephyr/dts/bindings/fingerprint/focaltech,ft9869.yaml
```yaml
# Copyright 2026 The Chromium OS Authors. All rights reserved.
# Use of this source code is governed by a BSD-style license that can be
# found in the LICENSE file.

description: FT9869 fingerprint sensor

compatible: "focaltech,ft9869"

include: [spi-device.yaml]

properties:
  irq-gpios:
    type: phandle-array
    required: true
    description: |
      This property specifies the connection for sensor interrupt.

  reset-gpios:
    type: phandle-array
    required: true
    description: |
      This property specifies the connection for sensor reset.
```

## zephyr/dts/bindings/leds/cros-ec,cbi-ufsc-lightbar-selector.yaml
```yaml
# Copyright 2026 The ChromiumOS Authors
# Use of this source code is governed by a BSD-style license that can be
# found in the LICENSE file.

include: base.yaml

description: UFSC-based Lightbar Golden Color Set Selector
compatible: "cros-ec,cbi-ufsc-lightbar-selector"

properties:
  selections:
    type: phandles
    required: true
    description: >
      Alternating list of <&ufsc_value &golden_color_set_node>.
      If UFSC matches the value, the paired golden color set is selected.

      The primary color set (e.g., UFSC = 0) defined in the main
      cros-ec,led-lightbar node can be omitted from this list; if no match
      is found, the primary color set (index 0) remains selected.
```

## zephyr/dts/bindings/leds/cros-ec,led-lightbar.yaml
```yaml
# Copyright 2025 The ChromiumOS Authors
# Use of this source code is governed by a BSD-style license that can be
# found in the LICENSE file.

description: CrOS EC LIGHTBAR LED

compatible: "cros-ec,led-lightbar"

properties:
  default-brightness-percent:
    type: int
    description: |
      Default brightness level in percent.
    default: 100
  min-brightness-percent:
    type: int
    description: |
      Minimal brightness level in percent.
    default: 0
  enable-gpios:
    type: phandle-array
    description: GPIO to enable/disable the lightbar power.
  ramp-up-delay-ms:
    type: int
    description: |
      Delay in ms to wait after enabling the lightbar power.
  led-segments:
    type: array
    description: |
      Array of bitmasks defining the physical segments.
  max-power-constrained-white-rgb:
    type: int
    description: |
      The maximum RGB value for White that keeps the lightbar's power
      consumption under the power limit (e.g., 100mW). Measured by EE.
      Format: 0xRRGGBB. Default is 0xFFFFFF.

# Provision in case we need per-LED animation
child-binding:
  description: |
    Node representing a LIGHTBAR instance.
  properties:
    led-id:
      type: string
      required: true
      description: |
        The EC LED ID for LIGHTBAR. This should match one of the values
        from the ec_led_id enum.
      enum:
        - "EC_LED_ID_BATTERY_LED"
        - "EC_LED_ID_POWER_LED"
        - "EC_LED_ID_ADAPTER_LED"
        - "EC_LED_ID_LEFT_LED"
        - "EC_LED_ID_RIGHT_LED"
        - "EC_LED_ID_RECOVERY_HW_REINIT_LED"
        - "EC_LED_ID_SYSRQ_DEBUG_LED"
        - "EC_LED_ID_LIGHTBAR_LED"
    strip:
      type: phandles
      required: true
      description: Phandle to the LED device.
  child-binding:
    description: Node representing a specific color for the LIGHTBAR LED.
    properties:
      led-color:
        type: string
        description: |
          The color this node represents. This should match one of the values
          from the led_color enum. It is optional, but required to support
          the EC_CMD_LED_CONTROL host command.
        enum:
          - "LED_OFF"
          - "LED_RED"
          - "LED_GREEN"
          - "LED_BLUE"
          - "LED_YELLOW"
          - "LED_WHITE"
          - "LED_AMBER"
          - "LED_MAGENTA"
          - "LED_IDLE"
      color:
        type: int
        required: true
        description: Hardware RGB value for the color (e.g., 0xFF0000 for red).
      srgb:
        type: int
        required: true
        description: sRGB value for the color (e.g., 0xFF0000 for red).
      segment-id:
        type: int
        description: |
          Logical ID of the segment (0-based index into led-segments).
          Default is -1 (All LEDs/Global).
      brightness-cap:
        type: string
        enum:
          - "CAP_WHITE_AC"
          - "CAP_WHITE_DIM"
        description: |
          If set, the entire lightbar's brightness will be capped dynamically
          based on the specified cap type: 100mW limit for "CAP_WHITE_DIM"
          (battery), and 250mW limit for "CAP_WHITE_AC" (calculated via
          max-power-constrained-white-rgb).
```

## zephyr/dts/bindings/leds/cros-ec,lightbar-golden-sets.yaml
```yaml
# Copyright 2026 The ChromiumOS Authors
# Use of this source code is governed by a BSD-style license that can be
# found in the LICENSE file.

description: CrOS EC Lightbar Alternative Golden Color Sets

compatible: "cros-ec,lightbar-golden-sets"

include:
  - name: cros-ec,led-lightbar.yaml
    property-allowlist: []
    child-binding:
      property-allowlist: []

child-binding:
  description: |
    Node representing an alternative golden color set (e.g., for UFSC > 0).
  properties:
    max-power-constrained-white-rgb:
      type: int
      description: |
        The maximum RGB value for White that keeps the lightbar's power
        consumption under the power limit (e.g., 100mW) for this color set.
        Format: 0xRRGGBB. If omitted, falls back to the lightbar node's
        max-power-constrained-white-rgb property.
```

## zephyr/dts/bindings/throttle/cros-ec,ap-throttle.yaml
```yaml
# Copyright 2026 The ChromiumOS Authors
# Use of this source code is governed by a BSD-style license that can be
# found in the LICENSE file.

description: GPIO-based AP power/thermal throttling driver

compatible: "cros-ec,ap-throttle"

include: base.yaml

properties:
  throttle-gpios:
    type: phandle-array
    required: true
    description: |
      GPIO pin connected to the AP throttle / PROCHOT signal (e.g.,
      EC_SYS_THROTTLE_MIRA or EC_SYS_THROTTLE_MIRA_ODL). Active level is
      determined by GPIO_ACTIVE_HIGH / GPIO_ACTIVE_LOW flags.
  ac-only-boot-throttle:
    type: boolean
    description: |
      Keep the throttle signal asserted throughout boot/S0 when booting on AC
      power without a battery present (battery_is_present() != BP_YES).
  g3s5-boot-throttle:
    type: boolean
    description: |
      Assert the AP throttle / PROCHOT signal during the G3 to S5 transition
      (POWER_G3S5) before AP power sequencing commences. This pre-throttles the
      SoC from its initial clock cycles during off-mode charging (e.g., on
      Qualcomm platforms where the AP powers on in S5 to run charging firmware),
      limiting inrush current and preventing VBUS resets or PMIC brownouts.
      The throttle is deasserted once the system transitions to S0 for normal
      OS operation.
```

## zephyr/lib/ap_power_console/Kconfig
```kconfig
# Copyright 2026 The ChromiumOS Authors
# Use of this source code is governed by a BSD-style license that can be
# found in the LICENSE file.

config AP_POWER_CONSOLE
	bool "AP power console command (power [on/off])"
	depends on AP_POWER_CONTROL && SHELL
	default y if PLATFORM_EC_POWERSEQ_SC7180 || PLATFORM_EC_POWERSEQ_SC7280
	default y if PLATFORM_EC_POWERSEQ_QC_EXP
	help
	  Enable the 'power [on/off]' shell command to query or control the AP
	  power state via the chipset API.
```

## zephyr/test/ap_power_console/testcase.yaml
```yaml
common:
  platform_allow:
    - native_sim
tests:
  ap_power_console.default: {}
```

## zephyr/test/ap_throttle/testcase.yaml
```yaml
# Copyright 2026 The ChromiumOS Authors
# Use of this source code is governed by a BSD-style license that can be
# found in the LICENSE file.

common:
  platform_allow:
    - native_sim
tests:
  ap_throttle.default: {}
  ap_throttle.no_ac_only_boot_throttle:
    extra_dtc_overlay_files:
      - boards/native_sim.overlay
      - boards/no_ac_only_boot_throttle.overlay
  ap_throttle.no_g3s5_boot_throttle:
    extra_dtc_overlay_files:
      - boards/native_sim.overlay
      - boards/no_g3s5_boot_throttle.overlay
  ap_throttle.no_boot_throttle:
    extra_dtc_overlay_files:
      - boards/native_sim.overlay
      - boards/no_ac_only_boot_throttle.overlay
      - boards/no_g3s5_boot_throttle.overlay
```

## zephyr/test/ish/testcase.yaml
```yaml
# Copyright 2024 The ChromiumOS Authors
# Use of this source code is governed by a BSD-style license that can be
# found in the LICENSE file.

common:
  platform_allow: native_sim
tests:
  # ISH notebook/tablet mode test
  ish.nb_mode:
    extra_dtc_overlay_files:
      - boards/native_sim.overlay
    extra_configs:
      - CONFIG_PLATFORM_EC_TABLET_MODE=y
      - CONFIG_PLATFORM_EC_EXTERNAL_NOTEBOOK_MODE=y
  # ISH HECI host command and sleep state test
  ish.heci_no_wake_mask:
    extra_dtc_overlay_files:
      - boards/native_sim.overlay
    extra_configs:
      - CONFIG_TEST_ISH_HECI=y
      - CONFIG_PLATFORM_EC_BACKLIGHT_LID=n
      - CONFIG_PLATFORM_EC_SWITCH=n
      - CONFIG_PLATFORM_EC_VBOOT_HASH=n
      - CONFIG_PLATFORM_EC_HOSTCMD=y
      - CONFIG_PLATFORM_EC_HOST_INTERFACE_HECI=y
      - CONFIG_PLATFORM_EC_MKBP_EVENT=y
      - CONFIG_PLATFORM_EC_MKBP_USE_HECI=y
      - CONFIG_SHIMMED_TASKS=y
```

## zephyr/test/ocelot/testcase.yaml
```yaml
# Copyright 2026 The ChromiumOS Authors
# Use of this source code is governed by a BSD-style license that can be
# found in the LICENSE file.

common:
  platform_allow:
    - native_sim
tests:
  ocelot.rvp_board_id:
    extra_configs:
      - CONFIG_TEST_OCELOT_RVP_BOARD_ID=y
  ocelot.blanc_board:
    extra_configs:
      - CONFIG_TEST_OCELOT_BLANC_BOARD=y
      - CONFIG_ADC=y
      - CONFIG_GPIO=y
      - CONFIG_GPIO_EMUL=y
      - CONFIG_I2C=y
      - CONFIG_I2C_EMUL=y
      - CONFIG_PLATFORM_EC_HOOKS=y
      - CONFIG_PWM=y
      - CONFIG_TEST_DISABLE_INLINE_CHIPSET_IN_STATE=y
    extra_dtc_overlay_files:
      - boards/blanc_board.overlay
      - boards/blanc_fan.overlay
```
