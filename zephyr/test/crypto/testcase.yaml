## zephyr/test/crypto/testcase.yaml
```yaml
common:
  platform_allow:
  - native_sim
tests:
  crypto.sha256:
    extra_configs:
    - CONFIG_TEST_SHA256=y
    - CONFIG_PLATFORM_EC_SHA256_SW=y
  crypto.x25519:
    extra_configs:
    - CONFIG_TEST_X25519=y
    - CONFIG_PLATFORM_EC_CURVE25519=y
```

## zephyr/test/debug_assert/testcase.yaml
```yaml
common:
  platform_allow:
    - native_sim
tests:
  debug_assert.default:
    extra_configs:
      - CONFIG_ASSERT_NO_FILE_INFO=n
  debug_assert.normal:
    extra_configs:
      - CONFIG_ASSERT_MODULE_DEFAULT_LEVEL_NORMAL=y
  debug_assert.no_file_info:
    extra_configs:
      - CONFIG_ASSERT_NO_FILE_INFO=y
```

## zephyr/test/drivers/board_id_intel_rvp/testcase.yaml
```yaml
common:
  platform_allow:
    - native_sim
tests:
  drivers.board_id_intel_rvp:
    extra_dtc_overlay_files:
      - boards/native_sim.overlay
    extra_configs:
      - CONFIG_LINK_TEST_SUITE_BOARD_ID_INTEL_RVP=y

  drivers.board_id_intel_rvp.not_ready:
    extra_dtc_overlay_files:
      - boards/native_sim.overlay
    extra_configs:
      - CONFIG_LINK_TEST_SUITE_BOARD_ID_INTEL_RVP_NOT_READY=y

  drivers.board_id_intel_rvp.s5_callback:
    extra_dtc_overlay_files:
      - boards/native_sim.overlay
    extra_configs:
      - CONFIG_LINK_TEST_SUITE_BOARD_ID_INTEL_RVP_S5_CALLBACK=y
```

## zephyr/test/ec-aic/pwrseq/testcase.yaml
```yaml
# Copyright 2026 The ChromiumOS Authors
# Use of this source code is governed by a BSD-style license that can be
# found in the LICENSE file.

common:
  platform_allow:
    - realtek/rts5912
  timeout: 120
tests:
  aic.pwrseq:
    harness: pytest
    harness_config:
      pytest_dut_scope: session
      pytest_root:
        - pytest/test_pwrseq.py
  aic.pwrseq.fault_injection:
    extra_configs:
      - CONFIG_AIC_PWRSEQ_FAULT_INJECTION=y
    extra_dtc_overlay_files:
      - boards/realtek_rts5912.overlay
      - fault_injection.overlay
    harness: pytest
    harness_config:
      pytest_dut_scope: session
      pytest_root:
        - pytest/test_pwrseq_fault.py
```

## zephyr/test/fatcat/Kconfig
```kconfig
# Copyright 2026 The ChromiumOS Authors
# Use of this source code is governed by a BSD-style license that can be
# found in the LICENSE file.

choice TEST_PROJECT_TYPE
	prompt "Select board variant for tests"
	help
	  Board variant to use for tests

	config TEST_PROJECT_LAPIS
		bool "Enable lapis-specific tests"
		help
		Enable tests for lapis variant.

endchoice # TEST_PROJECT_TYPE

config TEST_PROJECT_NAME
	string "Board name"
	default "lapis" if TEST_PROJECT_LAPIS

config TEST_PROJECT_BATTERY
	bool "Run the tests intended for battery.c"
	select AP_POWER_CONTROL
	help
	  Include project specific battery.c into the binary and test
	  their functions.

module = FATCAT
module-str = Fatcat board-specific code
source "subsys/logging/Kconfig.template.log_config"

source "Kconfig.zephyr"
```

## zephyr/test/fatcat/testcase.yaml
```yaml
# Copyright 2026 The ChromiumOS Authors
# Use of this source code is governed by a BSD-style license that can be
# found in the LICENSE file.

common:
  platform_allow:
    - native_sim
tests:
  # Lapis project tests
  fatcat.lapis:
    extra_configs:
      - CONFIG_TEST_PROJECT_LAPIS=y

  fatcat.lapis.battery:
    extra_dtc_overlay_files:
      - boards/lapis/battery.dtsi
    extra_configs:
      - CONFIG_TEST_PROJECT_LAPIS=y
      - CONFIG_TEST_PROJECT_BATTERY=y
      - CONFIG_PLATFORM_EC_HOOKS=y
      - CONFIG_PLATFORM_EC_BBRAM_TYPE_BBRAM=y
```

## zephyr/test/input_keyboard/testcase.yaml
```yaml
common:
  platform_allow:
    - native_sim
tests:
  input_keyboard.default: {}
  input_keyboard.ghost_filter:
    extra_configs:
      - CONFIG_CROS_EC_GHOST_FILTER=y
```

## zephyr/test/pwrmon/testcase.yaml
```yaml
common:
  platform_allow:
    - native_sim
tests:
  pwrmon.default:
    extra_configs:
      - CONFIG_PWRMON_POWER_MONITOR_COMMON=y

  pwrmon.pac194x:
    extra_configs:
      - CONFIG_PWRMON_POWER_MONITOR_PAC194X=y
```

## zephyr/test/qcom_ap_pwrseq/testcase.yaml
```yaml
# Copyright 2026 The ChromiumOS Authors
# Use of this source code is governed by a BSD-style license that can be
# found in the LICENSE file.

common:
  platform_allow:
    - native_sim
tests:
  qcom_ap_pwrseq.default: {}
  qcom_ap_pwrseq.ec_app_main:
    extra_configs:
      - CONFIG_TEST_EC_APP_MAIN=y
  qcom_ap_pwrseq.sysjump_s0:
    extra_configs:
      - CONFIG_TEST_SYSJUMP_S0=y
  qcom_ap_pwrseq.sysjump_s3:
    extra_configs:
      - CONFIG_TEST_SYSJUMP_S3=y
  qcom_ap_pwrseq.sysjump_g3:
    extra_configs:
      - CONFIG_TEST_SYSJUMP_G3=y
```

## zephyr/test/qcom_power/testcase.yaml
```yaml
common:
  platform_allow:
  - native_sim
tests:
  qcom_power.default: {}
  qcom_power.power_gpio_keys:
    extra_configs:
    - CONFIG_PLATFORM_EC_POWER_BUTTON=n
    extra_dtc_overlay_files:
    - ./boards/native_sim.overlay
    - ./boards/power_button.dtsi
  qcom_power.power_gpio_keys_ro:
    extra_configs:
    - CONFIG_CROS_EC_RO=y
    - CONFIG_PLATFORM_EC_POWER_BUTTON=n
    extra_dtc_overlay_files:
    - ./boards/native_sim.overlay
    - ./boards/power_button.dtsi
  qcom_power.power_gpio_keys_rw:
    extra_configs:
    - CONFIG_CROS_EC_RW=y
    - CONFIG_PLATFORM_EC_POWER_BUTTON=n
    extra_dtc_overlay_files:
    - ./boards/native_sim.overlay
    - ./boards/power_button.dtsi
```

## zephyr/test/rauru/testcase.yaml
```yaml
common:
  platform_allow:
  - native_sim
tests:
  rauru.usbc:
    extra_configs:
      - CONFIG_TEST_RAURU_USBC=y
      - CONFIG_SHIMMED_TASKS=y
    extra_dtc_overlay_files:
    - common.dtsi
  rauru.hylia:
    extra_configs:
      - CONFIG_TEST_RAURU_HYLIA=y
      - CONFIG_PLATFORM_EC_USB_PD_ALT_MODE_DFP=n
      - CONFIG_PLATFORM_EC_USB_PD_DP_MODE=n
      - CONFIG_PLATFORM_EC_USB_MUX_TASK=n
      - CONFIG_SHIMMED_TASKS=y
    extra_dtc_overlay_files:
    - common.dtsi
```

## zephyr/test/roach/testcase.yaml
```yaml
common:
  platform_allow:
  - native_sim
  extra_configs:
  - CONFIG_CROS_EC_RO=y
tests:
  roach.axii:
    extra_configs:
    - CONFIG_TEST_AXII=y
    extra_dtc_overlay_files:
    - axii.default.overlay
  roach.spikyrock:
    extra_configs:
    - CONFIG_TEST_SPIKYROCK=y
    - CONFIG_USBD_HID_VIVALDI=y
    - CONFIG_USBD_HID_KEYBOARD=y
    - CONFIG_USBD_HID_TOUCHPAD=y
    - CONFIG_USB_DEVICE_STACK_NEXT=y
    - CONFIG_USB_DEVICE_MANUFACTURER="Google"
    - CONFIG_USB_DEVICE_PRODUCT="Spikyrock"
    - CONFIG_USB_DEVICE_SN="0"
    - CONFIG_USB_DEVICE_VID=0x18D1
    - CONFIG_USB_DEVICE_PID=0x5067
    extra_dtc_overlay_files:
    - spikyrock.default.overlay
```

## zephyr/test/rwsig/testcase.yaml
```yaml
common:
  platform_allow:
    - native_sim
  extra_configs:
    - CONFIG_CROS_EC_RO=y
tests:
  rwsig.default: {}
```

## zephyr/test/skywalker/testcase.yaml
```yaml
common:
  platform_allow:
  - native_sim
tests:
  skywalker.skywalker:
    extra_configs:
      - CONFIG_TEST_SKYWALKER=y
      - CONFIG_SHIMMED_TASKS=y
    extra_dtc_overlay_files:
      - common.dtsi
  skywalker.anakin:
    extra_configs:
      - CONFIG_TEST_ANAKIN=y
      - CONFIG_SHIMMED_TASKS=y
      - CONFIG_PLATFORM_EC_CBI=y
      - CONFIG_PLATFORM_EC_DYNAMIC_MOTION_SENSOR_COUNT=y
    extra_dtc_overlay_files:
      - common.dtsi
      - anakin.dtsi
```

## zephyr/test/system_common/testcase.yaml
```yaml
common:
  platform_allow:
    - native_sim
tests:
  system.default:
    extra_configs:
      - CONFIG_SHELL_BACKEND_DUMMY=y
      - CONFIG_SHELL_BACKEND_DUMMY_BUF_SIZE=1000
      - CONFIG_SHELL_BACKEND_SERIAL=n
    tags:
      - common
      - system
  system.cortex_m_mpu:
    extra_configs:
      - CONFIG_SHELL_BACKEND_DUMMY=y
      - CONFIG_SHELL_BACKEND_DUMMY_BUF_SIZE=1000
      - CONFIG_SHELL_BACKEND_SERIAL=n
      - CONFIG_TEST_CORTEX_M_MPU=y
      - CONFIG_FLASH_BASE_ADDRESS=0x10058000
      - CONFIG_FLASH_SIZE=512
      - CONFIG_SRAM_BASE_ADDRESS=0x200c0000
      - CONFIG_SRAM_SIZE=64
    tags:
      - common
      - system
```

## zephyr/test/usb_updater/testcase.yaml
```yaml
common:
  platform_allow:
    - native_sim
  extra_configs:
    - CONFIG_CROS_EC_RO=y
tests:
  usb_updater.default: {}
```
