## CMakeLists.txt
```
# Copyright 2026 The ChromiumOS Authors
# Use of this source code is governed by a BSD-style license that can be
# found in the LICENSE file.

cmake_minimum_required(VERSION 3.20.0)

list(APPEND DTS_ROOT ${CMAKE_CURRENT_SOURCE_DIR})

find_package(Zephyr REQUIRED HINTS "${ZEPHYR_BASE}")
project(cros_bt_passthru_test)

target_include_directories(app PRIVATE
	${PLATFORM_EC}/third_party/chre/include
	${PLATFORM_EC}/zephyr/subsys/bt_passthru
	${CMAKE_CURRENT_SOURCE_DIR}/src
)

target_sources(app PRIVATE
	src/main.cc
	src/mock_hci_driver.c
	src/test_cros_hostcmd_transport.cc
	src/test_zephyr_bt_sender.cc
	src/test_bt_hci_interceptor.cc
	src/test_bt_passthru_flow.cc
)

target_link_libraries(app PRIVATE
	pw_span
	pw_status
	pw_function
)

add_subdirectory(${PLATFORM_EC}/zephyr/test/test_utils test_utils)
```

## prj.conf
```kconfig
# Copyright 2026 The ChromiumOS Authors
# Use of this source code is governed by a BSD-style license that can be
# found in the LICENSE file.

CONFIG_TEST=y
CONFIG_ZTEST=y
CONFIG_EMUL=y

CONFIG_CPP=y
CONFIG_STD_CPP20=y
CONFIG_REQUIRES_FULL_LIBCPP=y

CONFIG_CROS_EC=y
CONFIG_PLATFORM_EC=y
CONFIG_SHIMMED_TASKS=y
CONFIG_PLATFORM_EC_SWITCH=n
CONFIG_PLATFORM_EC_VBOOT_HASH=n
CONFIG_PLATFORM_EC_HOSTCMD=y
CONFIG_PLATFORM_EC_HOSTCMD_CONSOLE=y

CONFIG_BT=y
CONFIG_BT_HCI_RAW=y
CONFIG_BT_PASSTHRU=y

CONFIG_BT_PASSTHRU_LOG_LEVEL_DBG=y
CONFIG_BT_HCI_DRIVER_LOG_LEVEL_DBG=y
```

## boards/native_sim.overlay
```dts
/* Copyright 2026 The ChromiumOS Authors
 * Use of this source code is governed by a BSD-style license that can be
 * found in the LICENSE file.
 */

#include <board-overlays/native_sim.dts>

&bt_hci_userchan {
	status = "disabled";
};

/ {
	chosen {
		zephyr,bt-hci = &mock_bt_hci;
	};

	mock_bt_hci: mock_bt_hci {
		compatible = "zephyr,bt-hci-mock";
		status = "okay";
	};
};
```

## dts/bindings/zephyr,bt-hci-mock.yaml
```yaml
# Copyright 2026 The ChromiumOS Authors
# Use of this source code is governed by a BSD-style license that can be
# found in the LICENSE file.

description: Mock Bluetooth HCI Driver for unit testing

compatible: "zephyr,bt-hci-mock"

include: bt-hci.yaml

properties:
  bt-hci-name:
    default: "mock"
  bt-hci-bus:
    default: "virtual"
```

## src/main.cc
```c
/* Copyright 2026 The ChromiumOS Authors
 * Use of this source code is governed by a BSD-style license that can be
 * found in the LICENSE file.
 */

#include "test_common.h"

extern "C" {
DEFINE_FAKE_VALUE_FUNC(int, mkbp_send_event, uint8_t);
}

static void *bt_passthru_setup(void)
{
	return nullptr;
}

static void bt_passthru_before(void *fixture)
{
	ARG_UNUSED(fixture);
	mock_hci_driver_reset();
	RESET_FAKE(mkbp_send_event);
}

ZTEST_SUITE(bt_boot_init, NULL, bt_passthru_setup, bt_passthru_before, NULL,
	    NULL);

ZTEST(bt_boot_init, test_mock_driver_initialized)
{
	/* Verify that the mock driver was opened and ready */
	zassert_equal(mock_hci_driver_get_tx_count(), 0);
}

/* Test global SYS_INIT TX handler forwarding to controller */
ZTEST(bt_boot_init, test_sys_init_tx_forwarding)
{
	/* HCI Reset command */
	struct ec_param_bt_command req = {};
	req.size = 4;
	req.data[0] = BT_HCI_H4_CMD;
	req.data[1] = 0x03;
	req.data[2] = 0x0c;
	req.data[3] = 0x00;

	struct host_cmd_handler_args args =
		BUILD_HOST_COMMAND_PARAMS(EC_CMD_BT_COMMAND, 0, req);
	zassert_equal(host_command_process(&args), EC_RES_SUCCESS);

	/* Verify forwarded to mock HCI controller via SYS_INIT lambda */
	zassert_equal(mock_hci_driver_get_tx_count(), 1);
	auto tx_pkt = mock_hci_driver_get_last_tx_packet_vec();
	zassert_equal(tx_pkt.size(), req.size);
	zassert_mem_equal(tx_pkt.data(), req.data, req.size);
}

/* Test global SYS_INIT TX handler intercepting 0x1002 */
ZTEST(bt_boot_init, test_sys_init_tx_intercept)
{
	/* HCI Read Local Supported Commands: [H4_CMD] [0x02, 0x10] [0x00] */
	struct ec_param_bt_command req = {};
	req.size = 4;
	req.data[0] = BT_HCI_H4_CMD;
	req.data[1] = BT_HCI_OP_READ_SUPPORTED_COMMANDS & 0xff;
	req.data[2] = (BT_HCI_OP_READ_SUPPORTED_COMMANDS >> 8) & 0xff;
	req.data[3] = 0x00;

	struct host_cmd_handler_args args =
		BUILD_HOST_COMMAND_PARAMS(EC_CMD_BT_COMMAND, 0, req);
	zassert_equal(host_command_process(&args), EC_RES_SUCCESS);

	/* Verify intercepted: not forwarded to controller, MKBP triggered */
	zassert_equal(mock_hci_driver_get_tx_count(), 0);
	zassert_equal(mkbp_send_event_fake.call_count, 1);
}

/* Test RX thread consuming empty / 0-length buffer */
ZTEST(bt_boot_init, test_rx_empty_buffer)
{
	zassert_ok(mock_hci_driver_inject_empty_rx());

	/* Yield to let RX thread process the empty buffer */
	k_sleep(K_MSEC(20));

	/* Verify no MKBP event was generated */
	zassert_equal(mkbp_send_event_fake.call_count, 0);
}
```

## src/mock_hci_driver.c
```c
/* Copyright 2026 The ChromiumOS Authors
 * Use of this source code is governed by a BSD-style license that can be
 * found in the LICENSE file.
 */

#include "mock_hci_driver.h"

#include <string.h>

#include <zephyr/bluetooth/buf.h>
#include <zephyr/bluetooth/hci.h>
#include <zephyr/drivers/bluetooth.h>
#include <zephyr/kernel.h>
#include <zephyr/logging/log.h>

#define DT_DRV_COMPAT zephyr_bt_hci_mock

LOG_MODULE_REGISTER(mock_bt_hci, LOG_LEVEL_DBG);

#define MAX_TX_PACKETS 32
#define MAX_TX_PACKET_LEN 512

struct tx_packet {
	uint8_t data[MAX_TX_PACKET_LEN];
	size_t len;
};

static const struct device *g_mock_dev;
static struct tx_packet g_tx_packets[MAX_TX_PACKETS];
static size_t g_tx_packet_count;
static int g_send_result;

static int mock_open(const struct device *dev)
{
	g_mock_dev = dev;
	LOG_INF("mock_bt_hci open called");
	return 0;
}

static int mock_send(const struct device *dev, struct net_buf *buf)
{
	if (g_send_result != 0) {
		LOG_WRN("mock_bt_hci simulated send failure: %d",
			g_send_result);
		return g_send_result;
	}

	if (g_tx_packet_count < MAX_TX_PACKETS) {
		size_t copy_len = buf->len < MAX_TX_PACKET_LEN ?
					  buf->len :
					  MAX_TX_PACKET_LEN;
		memcpy(g_tx_packets[g_tx_packet_count].data, buf->data,
		       copy_len);
		g_tx_packets[g_tx_packet_count].len = copy_len;
		g_tx_packet_count++;
	}

	LOG_HEXDUMP_DBG(buf->data, buf->len, "Mock Controller RX <- Zephyr");
	net_buf_unref(buf);
	return 0;
}

static DEVICE_API(bt_hci, mock_drv_api) = {
	.open = mock_open,
	.send = mock_send,
};

#define MOCK_DEVICE_INIT(inst)                                        \
	static struct bt_hci_driver_data mock_data_##inst = {};       \
	static const struct bt_hci_driver_config mock_config_##inst = \
		BT_DT_HCI_DRIVER_CONFIG_INST_GET(inst);               \
	DEVICE_DT_INST_DEFINE(inst, NULL, NULL, &mock_data_##inst,    \
			      &mock_config_##inst, POST_KERNEL,       \
			      CONFIG_KERNEL_INIT_PRIORITY_DEVICE,     \
			      &mock_drv_api);

DT_INST_FOREACH_STATUS_OKAY(MOCK_DEVICE_INIT)

void mock_hci_driver_reset(void)
{
	g_tx_packet_count = 0;
	g_send_result = 0;
}

size_t mock_hci_driver_get_tx_count(void)
{
	return g_tx_packet_count;
}

size_t mock_hci_driver_get_last_tx_packet(uint8_t *out_buf, size_t max_len)
{
	if (g_tx_packet_count == 0 || out_buf == NULL) {
		return 0;
	}
	return mock_hci_driver_get_tx_packet(g_tx_packet_count - 1, out_buf,
					     max_len);
}

size_t mock_hci_driver_get_tx_packet(size_t index, uint8_t *out_buf,
				     size_t max_len)
{
	if (index >= g_tx_packet_count || out_buf == NULL) {
		return 0;
	}
	size_t len = g_tx_packets[index].len < max_len ?
			     g_tx_packets[index].len :
			     max_len;
	memcpy(out_buf, g_tx_packets[index].data, len);
	return len;
}

void mock_hci_driver_set_send_result(int res)
{
	g_send_result = res;
}

int mock_hci_driver_inject_rx(const uint8_t *data, size_t len)
{
	if (!g_mock_dev || !data || len == 0) {
		return -EINVAL;
	}

	struct net_buf *buf = bt_buf_get_rx(BT_BUF_EVT, K_NO_WAIT);
	if (!buf) {
		LOG_ERR("Failed to allocate mock RX buffer");
		return -ENOMEM;
	}

	/* bt_buf_get_rx(BT_BUF_EVT) already appends BT_HCI_H4_EVT (0x04).
	 * If the caller provided the H4 type prefix, skip it to avoid
	 * duplicate.
	 */
	if (data[0] == BT_HCI_H4_EVT) {
		net_buf_add_mem(buf, data + 1, len - 1);
	} else {
		net_buf_add_mem(buf, data, len);
	}
	bt_hci_recv(g_mock_dev, buf);

	return 0;
}

int mock_hci_driver_inject_empty_rx(void)
{
	if (!g_mock_dev) {
		return -EINVAL;
	}

	struct net_buf *buf = bt_buf_get_rx(BT_BUF_EVT, K_NO_WAIT);
	if (!buf) {
		LOG_ERR("Failed to allocate mock RX buffer");
		return -ENOMEM;
	}

	net_buf_reset(buf);
	bt_hci_recv(g_mock_dev, buf);

	return 0;
}
```

## src/mock_hci_driver.h
```c
/* Copyright 2026 The ChromiumOS Authors
 * Use of this source code is governed by a BSD-style license that can be
 * found in the LICENSE file.
 */

#ifndef ZEPHYR_TEST_BT_PASSTHRU_MOCK_HCI_DRIVER_H_
#define ZEPHYR_TEST_BT_PASSTHRU_MOCK_HCI_DRIVER_H_

#include <stddef.h>
#include <stdint.h>

#ifdef __cplusplus
#include <vector>
extern "C" {
#endif

void mock_hci_driver_reset(void);
size_t mock_hci_driver_get_tx_count(void);
size_t mock_hci_driver_get_last_tx_packet(uint8_t *out_buf, size_t max_len);
size_t mock_hci_driver_get_tx_packet(size_t index, uint8_t *out_buf,
				     size_t max_len);
void mock_hci_driver_set_send_result(int res);
int mock_hci_driver_inject_rx(const uint8_t *data, size_t len);
int mock_hci_driver_inject_empty_rx(void);

#ifdef __cplusplus
}

/* C++ helper functions */
inline std::vector<uint8_t> mock_hci_driver_get_last_tx_packet_vec(void)
{
	uint8_t buf[512];
	size_t len = mock_hci_driver_get_last_tx_packet(buf, sizeof(buf));
	if (len == 0) {
		return {};
	}
	return std::vector<uint8_t>(buf, buf + len);
}

inline std::vector<uint8_t> mock_hci_driver_get_tx_packet_vec(size_t index)
{
	uint8_t buf[512];
	size_t len = mock_hci_driver_get_tx_packet(index, buf, sizeof(buf));
	if (len == 0) {
		return {};
	}
	return std::vector<uint8_t>(buf, buf + len);
}
#endif

#endif /* ZEPHYR_TEST_BT_PASSTHRU_MOCK_HCI_DRIVER_H_ */
```

## src/test_bt_hci_interceptor.cc
```c
/* Copyright 2026 The ChromiumOS Authors
 * Use of this source code is governed by a BSD-style license that can be
 * found in the LICENSE file.
 */

#include "bt_passthru_hci_interceptor.h"
#include "test_common.h"

#include <zephyr/bluetooth/hci_types.h>
#include <zephyr/sys/byteorder.h>

#include <memory>

struct bt_hci_interceptor_fixture {
	chre::CrosHostcmdTransport transport;
	std::unique_ptr<chre::BtPassthruHciInterceptor> interceptor;

	void Reset()
	{
		RESET_FAKE(mkbp_send_event);
		transport.Start(
			[](uint32_t /*type*/,
			   pw::span<const uint8_t> /*payload*/,
			   chre::HostTransport::RespondToHost & /*cb*/) {
				return pw::OkStatus();
			});
		interceptor = std::make_unique<chre::BtPassthruHciInterceptor>(
			transport);

		/* Drain pending events */
		uint8_t drain[512];
		uint32_t count = 0;
		while (chre::CrosHostcmdTransport::GetPendingEvents(
			       drain, sizeof(drain), &count) > 0) {
		}
	}
};

static struct bt_hci_interceptor_fixture g_interceptor_fixture;

static void *interceptor_setup(void)
{
	return &g_interceptor_fixture;
}

static void interceptor_before(void *fixture)
{
	auto *f = static_cast<struct bt_hci_interceptor_fixture *>(fixture);
	f->Reset();
}

ZTEST_SUITE(bt_hci_interceptor, NULL, interceptor_setup, interceptor_before,
	    NULL, NULL);

/* Test malformed / invalid command interception rejection */
ZTEST_F(bt_hci_interceptor, test_intercept_invalid_inputs)
{
	/* Null buffer */
	zassert_false(fixture->interceptor->interceptCommand(
		nullptr, 10, chre::BtClientType::HOST));

	/* Length < 4 */
	uint8_t short_buf[3] = { BT_HCI_H4_CMD, 0x03, 0x0c };
	zassert_false(fixture->interceptor->interceptCommand(
		short_buf, sizeof(short_buf), chre::BtClientType::HOST));

	/* Invalid H4 type */
	uint8_t acl_buf[4] = { BT_HCI_H4_ACL, 0x00, 0x00, 0x00 };
	zassert_false(fixture->interceptor->interceptCommand(
		acl_buf, sizeof(acl_buf), chre::BtClientType::HOST));

	/* Truncated param length */
	uint8_t trunc_buf[5] = { BT_HCI_H4_CMD, 0x01, 0x20, 0x05, 0xaa };
	zassert_false(fixture->interceptor->interceptCommand(
		trunc_buf, sizeof(trunc_buf), chre::BtClientType::HOST));
}

/* Test non-intercepted command passes through (returns false) */
ZTEST_F(bt_hci_interceptor, test_passthrough_non_intercepted_command)
{
	/* HCI Reset: [H4_CMD] [0x03, 0x0c] [param_len=0] */
	uint8_t reset_cmd[] = { BT_HCI_H4_CMD, 0x03, 0x0c, 0x00 };
	zassert_false(fixture->interceptor->interceptCommand(
		reset_cmd, sizeof(reset_cmd), chre::BtClientType::HOST));

	/* Verify no events synthesized */
	uint8_t out_buf[64] = {};
	uint32_t num_events = 0;
	size_t bytes = chre::CrosHostcmdTransport::GetPendingEvents(
		out_buf, sizeof(out_buf), &num_events);
	zassert_equal(num_events, 0);
	zassert_equal(bytes, 0);
}

/* Test 0x1002 (Read Local Supported Commands) synthesis */
ZTEST_F(bt_hci_interceptor, test_synthesize_read_supported_commands)
{
	/* HCI Read Local Supported Commands: [H4_CMD] [0x02, 0x10] [0x00] */
	uint8_t read_supp_cmd[] = {
		BT_HCI_H4_CMD,
		BT_HCI_OP_READ_SUPPORTED_COMMANDS & 0xff,
		(BT_HCI_OP_READ_SUPPORTED_COMMANDS >> 8) & 0xff,
		0x00,
	};

	bool intercepted = fixture->interceptor->interceptCommand(
		read_supp_cmd, sizeof(read_supp_cmd), chre::BtClientType::HOST);
	zassert_true(intercepted);

	/* Verify MKBP wake event was triggered */
	zassert_equal(mkbp_send_event_fake.call_count, 1);
	zassert_equal(mkbp_send_event_fake.arg0_val, EC_MKBP_EVENT_BLUETOOTH);

	/* Retrieve synthesized event from ring buffer */
	uint8_t out_buf[128] = {};
	uint32_t num_events = 0;
	size_t total_bytes = chre::CrosHostcmdTransport::GetPendingEvents(
		out_buf, sizeof(out_buf), &num_events);

	zassert_equal(num_events, 1);
	uint8_t event_len = out_buf[0];
	const uint8_t *evt_payload = &out_buf[1];

	/* Expected event size: [H4_EVT(1)] + [bt_hci_evt_hdr(2)] +
	 * [bt_hci_evt_cmd_complete(3)] +
	 * [bt_hci_rp_read_supported_commands(65)] = 71 */
	size_t expected_size = 1 + sizeof(struct bt_hci_evt_hdr) +
			       sizeof(struct bt_hci_evt_cmd_complete) +
			       sizeof(struct bt_hci_rp_read_supported_commands);
	zassert_equal(event_len, expected_size);
	zassert_equal(total_bytes, expected_size + 1);

	/* Check H4 Type */
	zassert_equal(evt_payload[0], BT_HCI_H4_EVT);

	/* Check Event Header */
	const auto *evt_hdr = reinterpret_cast<const struct bt_hci_evt_hdr *>(
		&evt_payload[1]);
	zassert_equal(evt_hdr->evt, BT_HCI_EVT_CMD_COMPLETE);
	zassert_equal(evt_hdr->len,
		      sizeof(struct bt_hci_evt_cmd_complete) +
			      sizeof(struct bt_hci_rp_read_supported_commands));

	/* Check Command Complete Header */
	const auto *cc_hdr =
		reinterpret_cast<const struct bt_hci_evt_cmd_complete *>(
			evt_hdr->data);
	zassert_equal(cc_hdr->ncmd, 1);
	zassert_equal(sys_le16_to_cpu(cc_hdr->opcode),
		      BT_HCI_OP_READ_SUPPORTED_COMMANDS);

	/* Check Return Parameters */
	const auto *rp = reinterpret_cast<
		const struct bt_hci_rp_read_supported_commands *>(
		evt_hdr->data + sizeof(struct bt_hci_evt_cmd_complete));
	zassert_equal(rp->status, 0);

	/* Check Octet 36: bits 1..5 (0x3e) */
	zassert_equal(rp->commands[36], 0x3e);

	/* Check Octet 37: bits 5..6 (0x60) */
	zassert_equal(rp->commands[37], 0x60);

	/* Verify all other octets are 0 */
	for (size_t i = 0; i < sizeof(rp->commands); i++) {
		if (i != 36 && i != 37) {
			zassert_equal(rp->commands[i], 0,
				      "Octet %zu expected 0, got 0x%02x", i,
				      rp->commands[i]);
		}
	}
}

/* Test interceptCommandResponseEvent returns false */
ZTEST_F(bt_hci_interceptor, test_intercept_command_response_event)
{
	uint8_t sample_evt[10] = { BT_HCI_H4_EVT };
	zassert_false(fixture->interceptor->interceptCommandResponseEvent(
		sample_evt, sizeof(sample_evt)));
}
```

## src/test_bt_passthru_flow.cc
```c
/* Copyright 2026 The ChromiumOS Authors
 * Use of this source code is governed by a BSD-style license that can be
 * found in the LICENSE file.
 */

#include "test_common.h"

#include <zephyr/bluetooth/hci_types.h>
#include <zephyr/sys/byteorder.h>

#include <memory>

struct bt_passthru_flow_fixture {
	chre::CrosHostcmdTransport transport;
	chre::ZephyrBtSender sender;
	std::unique_ptr<chre::BtPassthruHciInterceptor> interceptor;

	void Reset()
	{
		RESET_FAKE(mkbp_send_event);
		mock_hci_driver_reset();

		interceptor = std::make_unique<chre::BtPassthruHciInterceptor>(
			transport);

		transport.Start(
			[this](uint32_t /*type*/, pw::span<const uint8_t> data,
			       chre::HostTransport::RespondToHost & /*resp*/) {
				if (interceptor->interceptCommand(
					    data.data(), data.size(),
					    chre::BtClientType::HOST)) {
					return pw::OkStatus();
				}

				sender.sendH4HciPacketToController(data.data(),
								   data.size());
				return pw::OkStatus();
			});

		/* Drain any pending ring buffer items */
		uint8_t drain_buf[512];
		uint32_t count = 0;
		while (chre::CrosHostcmdTransport::GetPendingEvents(
			       drain_buf, sizeof(drain_buf), &count) > 0) {
		}
	}
};

static struct bt_passthru_flow_fixture g_flow_fixture;

static void *flow_setup(void)
{
	return &g_flow_fixture;
}

static void flow_before(void *fixture)
{
	auto *f = static_cast<struct bt_passthru_flow_fixture *>(fixture);
	f->Reset();
}

ZTEST_SUITE(bt_passthru_flow, NULL, flow_setup, flow_before, NULL, NULL);

/* Test end-to-end: Host sends non-intercepted HCI command -> forwarded to
 * Controller */
ZTEST_F(bt_passthru_flow, test_e2e_host_command_to_controller)
{
	/* Prepare HCI Reset command: [H4_CMD(1)] [0x03, 0x0c (Opcode)] [0x00
	 * (Len)] */
	struct ec_param_bt_command req = {};
	req.size = 4;
	req.data[0] = BT_HCI_H4_CMD;
	req.data[1] = BT_HCI_OP_RESET & 0xff;
	req.data[2] = (BT_HCI_OP_RESET >> 8) & 0xff;
	req.data[3] = 0x00;

	struct host_cmd_handler_args args =
		BUILD_HOST_COMMAND_PARAMS(EC_CMD_BT_COMMAND, 0, req);
	zassert_equal(host_command_process(&args), EC_RES_SUCCESS);

	/* Verify forwarded to mock HCI controller */
	zassert_equal(mock_hci_driver_get_tx_count(), 1);
	auto tx_pkt = mock_hci_driver_get_last_tx_packet_vec();
	zassert_equal(tx_pkt.size(), req.size);
	zassert_mem_equal(tx_pkt.data(), req.data, req.size);

	/* Verify no MKBP event was generated */
	zassert_equal(mkbp_send_event_fake.call_count, 0);
}

/* Test end-to-end: Host sends 0x1002 -> intercepted & synthesized event read
 * via Host Command */
ZTEST_F(bt_passthru_flow, test_e2e_read_supported_commands_interception)
{
	/* Prepare 0x1002 HCI command */
	struct ec_param_bt_command req = {};
	req.size = 4;
	req.data[0] = BT_HCI_H4_CMD;
	req.data[1] = BT_HCI_OP_READ_SUPPORTED_COMMANDS & 0xff;
	req.data[2] = (BT_HCI_OP_READ_SUPPORTED_COMMANDS >> 8) & 0xff;
	req.data[3] = 0x00;

	struct host_cmd_handler_args cmd_args =
		BUILD_HOST_COMMAND_PARAMS(EC_CMD_BT_COMMAND, 0, req);
	zassert_equal(host_command_process(&cmd_args), EC_RES_SUCCESS);

	/* Verify NOT forwarded to mock HCI controller */
	zassert_equal(mock_hci_driver_get_tx_count(), 0);

	/* Verify MKBP event was generated */
	zassert_equal(mkbp_send_event_fake.call_count, 1);
	zassert_equal(mkbp_send_event_fake.arg0_val, EC_MKBP_EVENT_BLUETOOTH);

	/* Host polls EC_CMD_BT_READ_EVENT */
	struct ec_response_bt_read_event rsp = {};
	struct host_cmd_handler_args read_args =
		BUILD_HOST_COMMAND_RESPONSE(EC_CMD_BT_READ_EVENT, 0, rsp);
	zassert_equal(host_command_process(&read_args), EC_RES_SUCCESS);

	zassert_equal(rsp.num_events, 1);
	uint8_t event_len = rsp.events[0];
	zassert_equal(event_len,
		      1 + sizeof(struct bt_hci_evt_hdr) +
			      sizeof(struct bt_hci_evt_cmd_complete) +
			      sizeof(struct bt_hci_rp_read_supported_commands));
	const uint8_t *evt_payload = &rsp.events[1];

	/* Verify synthesized event format */
	zassert_equal(evt_payload[0], BT_HCI_H4_EVT);
	const auto *evt_hdr = reinterpret_cast<const struct bt_hci_evt_hdr *>(
		&evt_payload[1]);
	zassert_equal(evt_hdr->evt, BT_HCI_EVT_CMD_COMPLETE);

	const auto *cc_hdr =
		reinterpret_cast<const struct bt_hci_evt_cmd_complete *>(
			evt_hdr->data);
	zassert_equal(sys_le16_to_cpu(cc_hdr->opcode),
		      BT_HCI_OP_READ_SUPPORTED_COMMANDS);

	const auto *rp = reinterpret_cast<
		const struct bt_hci_rp_read_supported_commands *>(
		evt_hdr->data + sizeof(struct bt_hci_evt_cmd_complete));
	zassert_equal(rp->status, 0);
	zassert_equal(rp->commands[36], 0x3e);
	zassert_equal(rp->commands[37], 0x60);
}

/* Test end-to-end: Controller RX packet -> RX thread -> RingBuffer -> MKBP ->
 * Read Event */
ZTEST_F(bt_passthru_flow, test_e2e_controller_rx_to_host)
{
	/* Inject an HCI Event: e.g. LE Advertising Report (H4_EVT + EvtHdr +
	 * payload) */
	uint8_t rx_evt[] = {
		BT_HCI_H4_EVT,
		BT_HCI_EVT_LE_META_EVENT,
		0x0c, /* Parameter total length */
		BT_HCI_EVT_LE_ADVERTISING_REPORT,
		0x01, /* Num reports */
		0x00, /* Event type */
		0x00, /* Addr type */
		0x11,
		0x22,
		0x33,
		0x44,
		0x55,
		0x66, /* BD ADDR */
		0x00, /* Length data */
		0xce, /* RSSI */
	};

	zassert_ok(mock_hci_driver_inject_rx(rx_evt, sizeof(rx_evt)));

	/* Yield/sleep to let RX thread process the buffer */
	k_sleep(K_MSEC(20));

	/* Verify MKBP event was generated */
	zassert_equal(mkbp_send_event_fake.call_count, 1);
	zassert_equal(mkbp_send_event_fake.arg0_val, EC_MKBP_EVENT_BLUETOOTH);

	/* Host polls EC_CMD_BT_READ_EVENT */
	struct ec_response_bt_read_event rsp = {};
	struct host_cmd_handler_args read_args =
		BUILD_HOST_COMMAND_RESPONSE(EC_CMD_BT_READ_EVENT, 0, rsp);
	zassert_equal(host_command_process(&read_args), EC_RES_SUCCESS);

	zassert_equal(rsp.num_events, 1);
	zassert_equal(rsp.events[0], sizeof(rx_evt));
	zassert_mem_equal(&rsp.events[1], rx_evt, sizeof(rx_evt));
}

/* Test end-to-end: Full bidirectional Command -> Controller TX -> Controller RX
 * -> Read Event */
ZTEST_F(bt_passthru_flow, test_e2e_bidirectional_flow)
{
	/* Step 1: AP sends HCI Reset command */
	struct ec_param_bt_command req = {};
	req.size = 4;
	req.data[0] = BT_HCI_H4_CMD;
	req.data[1] = BT_HCI_OP_RESET & 0xff;
	req.data[2] = (BT_HCI_OP_RESET >> 8) & 0xff;
	req.data[3] = 0x00;

	struct host_cmd_handler_args cmd_args =
		BUILD_HOST_COMMAND_PARAMS(EC_CMD_BT_COMMAND, 0, req);
	zassert_equal(host_command_process(&cmd_args), EC_RES_SUCCESS);

	/* Verify controller received command */
	zassert_equal(mock_hci_driver_get_tx_count(), 1);

	/* Step 2: Controller responds with Command Complete event for Reset */
	uint8_t reset_complete_evt[] = {
		BT_HCI_H4_EVT,
		BT_HCI_EVT_CMD_COMPLETE,
		0x04, /* len */
		0x01, /* ncmd */
		BT_HCI_OP_RESET & 0xff,
		(BT_HCI_OP_RESET >> 8) & 0xff,
		BT_HCI_ERR_SUCCESS,
	};
	zassert_ok(mock_hci_driver_inject_rx(reset_complete_evt,
					     sizeof(reset_complete_evt)));

	/* Yield/sleep for RX thread */
	k_sleep(K_MSEC(20));

	/* Verify MKBP notification */
	zassert_equal(mkbp_send_event_fake.call_count, 1);

	/* Step 3: AP reads event */
	struct ec_response_bt_read_event rsp = {};
	struct host_cmd_handler_args read_args =
		BUILD_HOST_COMMAND_RESPONSE(EC_CMD_BT_READ_EVENT, 0, rsp);
	zassert_equal(host_command_process(&read_args), EC_RES_SUCCESS);

	zassert_equal(rsp.num_events, 1);
	zassert_equal(rsp.events[0], sizeof(reset_complete_evt));
	zassert_mem_equal(&rsp.events[1], reset_complete_evt,
			  sizeof(reset_complete_evt));
}

/* Test end-to-end: Burst of multiple RX packets from Controller */
ZTEST_F(bt_passthru_flow, test_e2e_burst_controller_rx)
{
	uint8_t evt1[] = { BT_HCI_H4_EVT, 0x01, 0x02, 0xaa };
	uint8_t evt2[] = { BT_HCI_H4_EVT, 0x02, 0x03, 0xbb, 0xcc };
	uint8_t evt3[] = { BT_HCI_H4_EVT, 0x03, 0x01, 0xdd };

	zassert_ok(mock_hci_driver_inject_rx(evt1, sizeof(evt1)));
	zassert_ok(mock_hci_driver_inject_rx(evt2, sizeof(evt2)));
	zassert_ok(mock_hci_driver_inject_rx(evt3, sizeof(evt3)));

	/* Sleep for thread processing */
	k_sleep(K_MSEC(30));

	/* Verify MKBP was called */
	zassert_true(mkbp_send_event_fake.call_count >= 1);

	/* Read all events in one batch */
	struct ec_response_bt_read_event rsp = {};
	struct host_cmd_handler_args read_args =
		BUILD_HOST_COMMAND_RESPONSE(EC_CMD_BT_READ_EVENT, 0, rsp);
	zassert_equal(host_command_process(&read_args), EC_RES_SUCCESS);

	zassert_equal(rsp.num_events, 3);

	size_t offset = 0;
	zassert_equal(rsp.events[offset++], sizeof(evt1));
	zassert_mem_equal(&rsp.events[offset], evt1, sizeof(evt1));
	offset += sizeof(evt1);

	zassert_equal(rsp.events[offset++], sizeof(evt2));
	zassert_mem_equal(&rsp.events[offset], evt2, sizeof(evt2));
	offset += sizeof(evt2);

	zassert_equal(rsp.events[offset++], sizeof(evt3));
	zassert_mem_equal(&rsp.events[offset], evt3, sizeof(evt3));
}
```

## src/test_common.h
```c
/* Copyright 2026 The ChromiumOS Authors
 * Use of this source code is governed by a BSD-style license that can be
 * found in the LICENSE file.
 */

#ifndef ZEPHYR_TEST_BT_PASSTHRU_TEST_COMMON_H_
#define ZEPHYR_TEST_BT_PASSTHRU_TEST_COMMON_H_

#include "bt_passthru_hci_interceptor.h"
#include "cros_hostcmd_transport.h"
#include "ec_commands.h"
#include "host_command.h"
#include "mock_hci_driver.h"
#include "zephyr_bt_sender.h"

#include <zephyr/bluetooth/bluetooth.h>
#include <zephyr/bluetooth/hci_types.h>
#include <zephyr/fff.h>
#include <zephyr/kernel.h>
#include <zephyr/ztest.h>

extern "C" {
DECLARE_FAKE_VALUE_FUNC(int, mkbp_send_event, uint8_t);
}

#endif /* ZEPHYR_TEST_BT_PASSTHRU_TEST_COMMON_H_ */
```

## src/test_cros_hostcmd_transport.cc
```c
/* Copyright 2026 The ChromiumOS Authors
 * Use of this source code is governed by a BSD-style license that can be
 * found in the LICENSE file.
 */

#include "test_common.h"

#include <vector>

struct cros_hostcmd_transport_fixture {
	chre::CrosHostcmdTransport transport;
	std::vector<uint8_t> last_inbound_cmd;
	pw::Status inbound_status = pw::OkStatus();

	void Reset()
	{
		last_inbound_cmd.clear();
		inbound_status = pw::OkStatus();
		RESET_FAKE(mkbp_send_event);
		mock_hci_driver_reset();

		/* Re-initialize transport */
		transport.Start(
			[this](uint32_t /*type*/,
			       pw::span<const uint8_t> payload,
			       chre::HostTransport::RespondToHost & /*cb*/) {
				last_inbound_cmd.assign(payload.begin(),
							payload.end());
				return inbound_status;
			});

		/* Drain any pending ring buffer items */
		uint8_t drain_buf[512];
		uint32_t count = 0;
		while (chre::CrosHostcmdTransport::GetPendingEvents(
			       drain_buf, sizeof(drain_buf), &count) > 0) {
		}
	}
};

static struct cros_hostcmd_transport_fixture g_fixture;

static void *hostcmd_transport_setup(void)
{
	return &g_fixture;
}

static void hostcmd_transport_before(void *fixture)
{
	auto *f = static_cast<struct cros_hostcmd_transport_fixture *>(fixture);
	f->Reset();
}

ZTEST_SUITE(cros_hostcmd_transport, NULL, hostcmd_transport_setup,
	    hostcmd_transport_before, NULL, NULL);

/* Test Start() parameter validation */
ZTEST_F(cros_hostcmd_transport, test_start_validation)
{
	chre::CrosHostcmdTransport t;
	zassert_equal(t.Start(nullptr), pw::Status::InvalidArgument());
}

/* Test Write() parameter validation */
ZTEST_F(cros_hostcmd_transport, test_write_validation)
{
	/* Empty data */
	zassert_equal(fixture->transport.Write(0, {}, false),
		      pw::Status::InvalidArgument());

	/* Oversized data > 255 bytes */
	uint8_t huge_buf[256] = {};
	zassert_equal(fixture->transport.Write(0, huge_buf, false),
		      pw::Status::InvalidArgument());
}

/* Test Write() with wakeUp=true triggers MKBP */
ZTEST_F(cros_hostcmd_transport, test_write_wakeup_triggers_mkbp)
{
	uint8_t evt[] = { 0x04, 0x0e, 0x04, 0x01, 0x03, 0x0c, 0x00 };
	zassert_equal(fixture->transport.Write(0, evt, true), pw::OkStatus());

	zassert_equal(mkbp_send_event_fake.call_count, 1);
	zassert_equal(mkbp_send_event_fake.arg0_val, EC_MKBP_EVENT_BLUETOOTH);

	/* Read event via GetPendingEvents */
	uint8_t out_buf[64] = {};
	uint32_t num_events = 0;
	size_t bytes = chre::CrosHostcmdTransport::GetPendingEvents(
		out_buf, sizeof(out_buf), &num_events);

	zassert_equal(num_events, 1);
	zassert_equal(bytes, sizeof(evt) + 1); /* 1 length byte + payload */
	zassert_equal(out_buf[0], sizeof(evt));
	zassert_mem_equal(&out_buf[1], evt, sizeof(evt));
}

/* Test Write() with wakeUp=false does NOT trigger MKBP */
ZTEST_F(cros_hostcmd_transport, test_write_no_wakeup_skips_mkbp)
{
	uint8_t evt[] = { 0x04, 0x0e, 0x04, 0x01, 0x03, 0x0c, 0x00 };
	zassert_equal(fixture->transport.Write(0, evt, false), pw::OkStatus());

	zassert_equal(mkbp_send_event_fake.call_count, 0);

	/* Events are still queued */
	uint8_t out_buf[64] = {};
	uint32_t num_events = 0;
	size_t bytes = chre::CrosHostcmdTransport::GetPendingEvents(
		out_buf, sizeof(out_buf), &num_events);

	zassert_equal(num_events, 1);
	zassert_equal(bytes, sizeof(evt) + 1);
}

/* Test FIFO ordering and packing of multiple events */
ZTEST_F(cros_hostcmd_transport, test_fifo_multiple_events)
{
	uint8_t evt1[] = { 0x01, 0x02 };
	uint8_t evt2[] = { 0x03, 0x04, 0x05 };
	uint8_t evt3[] = { 0x06, 0x07, 0x08, 0x09 };

	zassert_equal(fixture->transport.Write(0, evt1, false), pw::OkStatus());
	zassert_equal(fixture->transport.Write(0, evt2, false), pw::OkStatus());
	zassert_equal(fixture->transport.Write(0, evt3, false), pw::OkStatus());

	uint8_t out_buf[64] = {};
	uint32_t num_events = 0;
	size_t bytes = chre::CrosHostcmdTransport::GetPendingEvents(
		out_buf, sizeof(out_buf), &num_events);

	zassert_equal(num_events, 3);
	size_t expected_total =
		(1 + sizeof(evt1)) + (1 + sizeof(evt2)) + (1 + sizeof(evt3));
	zassert_equal(bytes, expected_total);

	/* Check unpacking: len + data */
	size_t idx = 0;
	zassert_equal(out_buf[idx++], sizeof(evt1));
	zassert_mem_equal(&out_buf[idx], evt1, sizeof(evt1));
	idx += sizeof(evt1);

	zassert_equal(out_buf[idx++], sizeof(evt2));
	zassert_mem_equal(&out_buf[idx], evt2, sizeof(evt2));
	idx += sizeof(evt2);

	zassert_equal(out_buf[idx++], sizeof(evt3));
	zassert_mem_equal(&out_buf[idx], evt3, sizeof(evt3));
}

/* Test partial read when output buffer cannot fit all events */
ZTEST_F(cros_hostcmd_transport, test_partial_buffer_packing)
{
	uint8_t evt1[20] = { 0x11 };
	uint8_t evt2[20] = { 0x22 };

	zassert_equal(fixture->transport.Write(0, evt1, false), pw::OkStatus());
	zassert_equal(fixture->transport.Write(0, evt2, false), pw::OkStatus());

	/* Out buffer can fit only 1 event: 1 + 20 = 21 bytes */
	uint8_t out_buf[30] = {};
	uint32_t num_events = 0;
	size_t bytes = chre::CrosHostcmdTransport::GetPendingEvents(
		out_buf, 25, &num_events);

	zassert_equal(num_events, 1);
	zassert_equal(bytes, 21);
	zassert_equal(out_buf[0], 20);

	/* Next read retrieves the second event */
	bytes = chre::CrosHostcmdTransport::GetPendingEvents(
		out_buf, sizeof(out_buf), &num_events);
	zassert_equal(num_events, 1);
	zassert_equal(bytes, 21);
	zassert_equal(out_buf[0], 20);
}

/* Test deadlock protection: single event larger than max_size is dropped */
ZTEST_F(cros_hostcmd_transport, test_deadlock_protection)
{
	uint8_t huge_evt[100] = { 0xaa };
	uint8_t normal_evt[10] = { 0xbb };

	zassert_equal(fixture->transport.Write(0, huge_evt, false),
		      pw::OkStatus());
	zassert_equal(fixture->transport.Write(0, normal_evt, false),
		      pw::OkStatus());

	/* max_size is 50, so huge_evt (101 bytes) cannot fit and must be
	 * discarded */
	uint8_t out_buf[50] = {};
	uint32_t num_events = 0;
	size_t bytes = chre::CrosHostcmdTransport::GetPendingEvents(
		out_buf, sizeof(out_buf), &num_events);

	zassert_equal(num_events, 1);
	zassert_equal(bytes, 11); /* 1 length byte + 10 normal_evt */
	zassert_equal(out_buf[0], 10);
	zassert_mem_equal(&out_buf[1], normal_evt, sizeof(normal_evt));
}

/* Test ring buffer overflow returns ResourceExhausted and does not corrupt
 * existing data */
ZTEST_F(cros_hostcmd_transport, test_ring_buf_overflow)
{
	uint8_t pkt[200] = {};
	int successful_writes = 0;
	bool overflowed = false;

	for (int i = 0; i < 60; i++) {
		pkt[0] = static_cast<uint8_t>(i);
		pw::Status status = fixture->transport.Write(0, pkt, false);
		if (status.ok()) {
			successful_writes++;
		} else {
			zassert_equal(status, pw::Status::ResourceExhausted());
			overflowed = true;
			break;
		}
	}

	zassert_true(successful_writes > 0);
	zassert_true(overflowed);

	/* Verify queued data can be drained correctly */
	uint8_t out_buf[512] = {};
	uint32_t total_events = 0;
	uint32_t num_events = 0;
	while (chre::CrosHostcmdTransport::GetPendingEvents(
		       out_buf, sizeof(out_buf), &num_events) > 0) {
		total_events += num_events;
	}
	zassert_equal(total_events, successful_writes);
}

/* Test EC_CMD_BT_COMMAND host command */
ZTEST_F(cros_hostcmd_transport, test_host_command_bt_command)
{
	/* Invalid param: size = 0 */
	struct ec_param_bt_command req = {};
	req.size = 0;
	struct host_cmd_handler_args args =
		BUILD_HOST_COMMAND_PARAMS(EC_CMD_BT_COMMAND, 0, req);
	zassert_equal(host_command_process(&args), EC_RES_INVALID_PARAM);

	/* Invalid param: size > BT_MAX_COMMAND_SIZE */
	req.size = BT_MAX_COMMAND_SIZE + 1;
	args = BUILD_HOST_COMMAND_PARAMS(EC_CMD_BT_COMMAND, 0, req);
	zassert_equal(host_command_process(&args), EC_RES_INVALID_PARAM);

	/* Invalid param: request shorter than the size field */
	req.size = 3;
	args = BUILD_HOST_COMMAND_PARAMS(EC_CMD_BT_COMMAND, 0, req);
	args.params_size = sizeof(req.size) - 1;
	zassert_equal(host_command_process(&args), EC_RES_INVALID_PARAM);

	/* Invalid param: request shorter than the declared payload */
	args = BUILD_HOST_COMMAND_PARAMS(EC_CMD_BT_COMMAND, 0, req);
	args.params_size = sizeof(req.size) + req.size - 1;
	zassert_equal(host_command_process(&args), EC_RES_INVALID_PARAM);

	/* Valid command */
	req.size = 3;
	req.data[0] = 0x03;
	req.data[1] = 0x0c;
	req.data[2] = 0x00;
	args = BUILD_HOST_COMMAND_PARAMS(EC_CMD_BT_COMMAND, 0, req);
	zassert_equal(host_command_process(&args), EC_RES_SUCCESS);

	zassert_equal(fixture->last_inbound_cmd.size(), 3);
	zassert_equal(fixture->last_inbound_cmd[0], 0x03);
	zassert_equal(fixture->last_inbound_cmd[1], 0x0c);
	zassert_equal(fixture->last_inbound_cmd[2], 0x00);

	/* Largest H:4 command: 255 parameter bytes (1 + 3 + 255 = 259) */
	req.size = 1 + 3 + 255;
	req.data[0] = 0x01;
	req.data[1] = 0x37;
	req.data[2] = 0x20;
	req.data[3] = 0xff;
	for (size_t i = 4; i < req.size; i++) {
		req.data[i] = static_cast<uint8_t>(i);
	}
	args = BUILD_HOST_COMMAND_PARAMS(EC_CMD_BT_COMMAND, 0, req);
	zassert_equal(host_command_process(&args), EC_RES_SUCCESS);

	zassert_equal(fixture->last_inbound_cmd.size(), req.size);
	zassert_mem_equal(fixture->last_inbound_cmd.data(), req.data, req.size);

	/* Error from inbound handler */
	fixture->inbound_status = pw::Status::Internal();
	args = BUILD_HOST_COMMAND_PARAMS(EC_CMD_BT_COMMAND, 0, req);
	zassert_equal(host_command_process(&args), EC_RES_ERROR);
}

/* Test EC_CMD_BT_READ_EVENT host command */
ZTEST_F(cros_hostcmd_transport, test_host_command_bt_read_event)
{
	struct ec_response_bt_read_event rsp = {};
	struct host_cmd_handler_args args =
		BUILD_HOST_COMMAND_RESPONSE(EC_CMD_BT_READ_EVENT, 0, rsp);

	/* Empty ring buffer returns EC_RES_SUCCESS with num_events = 0 */
	zassert_equal(host_command_process(&args), EC_RES_SUCCESS);
	zassert_equal(rsp.num_events, 0);
	zassert_equal(args.response_size, sizeof(rsp.num_events));

	/* Write an event */
	uint8_t evt[] = { 0x04, 0x0e, 0x04, 0x01, 0x03, 0x0c, 0x00 };
	zassert_equal(fixture->transport.Write(0, evt, false), pw::OkStatus());

	/* Now read it via host command */
	zassert_equal(host_command_process(&args), EC_RES_SUCCESS);
	zassert_equal(rsp.num_events, 1);
	zassert_equal(rsp.events[0], sizeof(evt));
	zassert_mem_equal(&rsp.events[1], evt, sizeof(evt));
	zassert_equal(args.response_size,
		      sizeof(rsp.num_events) + 1 + sizeof(evt));

	/* Second read returns num_events = 0 because buffer was drained */
	zassert_equal(host_command_process(&args), EC_RES_SUCCESS);
	zassert_equal(rsp.num_events, 0);
	zassert_equal(args.response_size, sizeof(rsp.num_events));

	/* Max-size 255-byte H:4 event fits in a single response (1 + 255 =
	 * 256) */
	uint8_t max_evt[255];
	for (size_t i = 0; i < sizeof(max_evt); i++) {
		max_evt[i] = static_cast<uint8_t>(i);
	}
	zassert_equal(fixture->transport.Write(0, max_evt, false),
		      pw::OkStatus());

	memset(&rsp, 0, sizeof(rsp));
	args = BUILD_HOST_COMMAND_RESPONSE(EC_CMD_BT_READ_EVENT, 0, rsp);
	zassert_equal(host_command_process(&args), EC_RES_SUCCESS);
	zassert_equal(rsp.num_events, 1);
	zassert_equal(rsp.events[0], sizeof(max_evt));
	zassert_mem_equal(&rsp.events[1], max_evt, sizeof(max_evt));
	zassert_equal(args.response_size,
		      sizeof(rsp.num_events) + 1 + sizeof(max_evt));
}
```

## src/test_zephyr_bt_sender.cc
```c
/* Copyright 2026 The ChromiumOS Authors
 * Use of this source code is governed by a BSD-style license that can be
 * found in the LICENSE file.
 */

#include "test_common.h"
#include "zephyr_bt_sender.h"

struct zephyr_bt_sender_fixture {
	chre::ZephyrBtSender sender;

	void Reset()
	{
		mock_hci_driver_reset();
	}
};

static struct zephyr_bt_sender_fixture g_sender_fixture;

static void *sender_setup(void)
{
	return &g_sender_fixture;
}

static void sender_before(void *fixture)
{
	auto *f = static_cast<struct zephyr_bt_sender_fixture *>(fixture);
	f->Reset();
}

ZTEST_SUITE(zephyr_bt_sender, NULL, sender_setup, sender_before, NULL, NULL);

/* Test sending malformed / invalid packets */
ZTEST_F(zephyr_bt_sender, test_send_invalid_packets)
{
	/* Null buffer */
	fixture->sender.sendH4HciPacketToController(nullptr, 10);
	zassert_equal(mock_hci_driver_get_tx_count(), 0);

	/* Length < 4 */
	uint8_t short_pkt[3] = { BT_HCI_H4_CMD, 0x03, 0x0c };
	fixture->sender.sendH4HciPacketToController(short_pkt,
						    sizeof(short_pkt));
	zassert_equal(mock_hci_driver_get_tx_count(), 0);

	/* Unsupported H4 Type (ACL data) */
	uint8_t acl_pkt[5] = { BT_HCI_H4_ACL, 0x01, 0x00, 0x01, 0x00 };
	fixture->sender.sendH4HciPacketToController(acl_pkt, sizeof(acl_pkt));
	zassert_equal(mock_hci_driver_get_tx_count(), 0);

	/* Truncated command payload */
	uint8_t trunc_pkt[5] = { BT_HCI_H4_CMD, 0x01, 0x20, 0x05, 0x11 };
	fixture->sender.sendH4HciPacketToController(trunc_pkt,
						    sizeof(trunc_pkt));
	zassert_equal(mock_hci_driver_get_tx_count(), 0);
}

/* Test sending valid HCI command to controller */
ZTEST_F(zephyr_bt_sender, test_send_valid_hci_command)
{
	/* HCI Reset: [0x01 (H4)] [0x03, 0x0c (Opcode)] [0x00 (Param Len)] */
	uint8_t reset_cmd[] = { BT_HCI_H4_CMD, 0x03, 0x0c, 0x00 };
	fixture->sender.sendH4HciPacketToController(reset_cmd,
						    sizeof(reset_cmd));

	zassert_equal(mock_hci_driver_get_tx_count(), 1);

	auto tx_packet = mock_hci_driver_get_last_tx_packet_vec();
	zassert_equal(tx_packet.size(), sizeof(reset_cmd));
	zassert_mem_equal(tx_packet.data(), reset_cmd, sizeof(reset_cmd));
}

/* Test sending command with parameters */
ZTEST_F(zephyr_bt_sender, test_send_command_with_parameters)
{
	/* HCI LE Set Scan Enable: Opcode 0x200c, param_len 2, params [0x01,
	 * 0x00] */
	uint8_t scan_cmd[] = { BT_HCI_H4_CMD, 0x0c, 0x20, 0x02, 0x01, 0x00 };
	fixture->sender.sendH4HciPacketToController(scan_cmd, sizeof(scan_cmd));

	zassert_equal(mock_hci_driver_get_tx_count(), 1);

	auto tx_packet = mock_hci_driver_get_last_tx_packet_vec();
	zassert_equal(tx_packet.size(), sizeof(scan_cmd));
	zassert_mem_equal(tx_packet.data(), scan_cmd, sizeof(scan_cmd));
}

/* Test trimming trailing bytes past declared HCI command parameter length */
ZTEST_F(zephyr_bt_sender, test_send_command_trims_trailing_bytes)
{
	/* HCI Reset (param_len = 0) with 2 trailing padding bytes */
	uint8_t padded_cmd[] = { BT_HCI_H4_CMD, 0x03, 0x0c, 0x00, 0x00, 0xff };
	fixture->sender.sendH4HciPacketToController(padded_cmd,
						    sizeof(padded_cmd));

	zassert_equal(mock_hci_driver_get_tx_count(), 1);

	auto tx_packet = mock_hci_driver_get_last_tx_packet_vec();
	zassert_equal(tx_packet.size(), 4);
	zassert_mem_equal(tx_packet.data(), padded_cmd, 4);
}

/* Test driver error handling during send */
ZTEST_F(zephyr_bt_sender, test_send_driver_failure)
{
	mock_hci_driver_set_send_result(-EIO);

	uint8_t reset_cmd[] = { BT_HCI_H4_CMD, 0x03, 0x0c, 0x00 };
	/* Should handle failure gracefully without crashing */
	fixture->sender.sendH4HciPacketToController(reset_cmd,
						    sizeof(reset_cmd));

	/* Since mock driver returned error before recording, TX count is 0 */
	zassert_equal(mock_hci_driver_get_tx_count(), 0);
}

/* Test TX buffer allocation failure when the command pool runs dry */
ZTEST_F(zephyr_bt_sender, test_send_tx_pool_exhausted)
{
	uint8_t reset_cmd[] = { BT_HCI_H4_CMD, 0x03, 0x0c, 0x00 };
	size_t sent = 0;

	/*
	 * The mock driver keeps every buffer it gets, so the pool drains
	 * after a few commands. The pool is far smaller than the 32 packets
	 * the mock driver can record.
	 */
	mock_hci_driver_set_hold_tx_bufs(true);
	for (int i = 0; i < 32; i++) {
		fixture->sender.sendH4HciPacketToController(reset_cmd,
							    sizeof(reset_cmd));
		if (mock_hci_driver_get_tx_count() == sent) {
			break;
		}
		sent = mock_hci_driver_get_tx_count();
	}

	/* Some commands went out, then one was dropped without a buffer */
	zassert_true(sent > 0);
	zassert_true(sent < 32);
	zassert_equal(mock_hci_driver_get_tx_count(), sent);
}
```
