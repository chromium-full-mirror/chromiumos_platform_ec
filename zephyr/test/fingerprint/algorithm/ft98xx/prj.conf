## CMakeLists.txt
```
# Copyright 2026 The ChromiumOS Authors
# Use of this source code is governed by a BSD-style license that can be
# found in the LICENSE file.

cmake_minimum_required(VERSION 3.13.1)
find_package(Zephyr REQUIRED HINTS "${ZEPHYR_BASE}")
project(fingerprint_algorithm_ft98xx)

target_sources(app PRIVATE
     src/ft98xx.c
    "${PLATFORM_EC}/zephyr/subsys/fingerprint/alg/ft98xx_bio_alg.c"
)

zephyr_include_directories("${CMAKE_CURRENT_SOURCE_DIR}/include")

# Enable private algorithm path for unit test mocking.
target_compile_definitions(app PRIVATE
    CONFIG_HAVE_FT_LOCKER_PRIVATE_ALGORITHM=1
)
```

## prj.conf
```kconfig
# Copyright 2026 The ChromiumOS Authors
# Use of this source code is governed by a BSD-style license that can be
# found in the LICENSE file.

CONFIG_ZTEST=y
CONFIG_FINGERPRINT_SUBSYSTEM=y
CONFIG_FINGERPRINT_SENSOR=y
CONFIG_FP_FT9849_ALGORITHM=y
CONFIG_FP_ALGORITHM_TEMPLATE_SIZE=1024
```

## include/ft98xx_algo_mocks.h
```c
/* Copyright 2026 The ChromiumOS Authors
 * Use of this source code is governed by a BSD-style license that can be
 * found in the LICENSE file.
 */

#ifndef PLATFORM_EC_ZEPHYR_TEST_FINGERPRINT_ALGORITHM_FT98XX_INCLUDE_FT98XX_ALGO_MOCKS_H_
#define PLATFORM_EC_ZEPHYR_TEST_FINGERPRINT_ALGORITHM_FT98XX_INCLUDE_FT98XX_ALGO_MOCKS_H_

#include <stdbool.h>
#include <stdint.h>

#include <zephyr/fff.h>

#include <drivers/fingerprint/fingerprint_ft98xx_private.h>

/* Mock sensor query APIs. */
DECLARE_FAKE_VALUE_FUNC(uint16_t, ft_sensor_query_rows);
DECLARE_FAKE_VALUE_FUNC(uint16_t, ft_sensor_query_cols);

/*
 * Mock focal algorithm APIs matching fingerprint_ft98xx_private.h exact types.
 */
DECLARE_FAKE_VALUE_FUNC(int, focal_algo_set_buffer, uint16_t *, uint8_t *,
			uint8_t *);

DECLARE_FAKE_VALUE_FUNC(int, focal_algo_init, algo_param_t);
DECLARE_FAKE_VALUE_FUNC(int, focal_algo_deinit);
DECLARE_FAKE_VALUE_FUNC(int, focal_algo_get_finger_detailed_info, int *, int *,
			int *);
DECLARE_FAKE_VOID_FUNC(focal_algo_version, uint8_t *);
DECLARE_FAKE_VALUE_FUNC(int, focal_algo_enroll_start);
DECLARE_FAKE_VALUE_FUNC(int, focal_algo_get_feature, uint8_t *, uint8_t *,
			int *);
DECLARE_FAKE_VALUE_FUNC(int, focal_algo_enroll_step, uint8_t *, uint8_t);
DECLARE_FAKE_VALUE_FUNC(int, focal_algo_enroll_finish, uint8_t *, uint32_t *);
DECLARE_FAKE_VALUE_FUNC(int, focal_algo_enroll_cancel);
DECLARE_FAKE_VALUE_FUNC(int, focal_algo_match, uint8_t *, uint8_t *, uint8_t *);
DECLARE_FAKE_VALUE_FUNC(int, focal_algo_anti_spoofing, uint16_t *);
DECLARE_FAKE_VALUE_FUNC(int, focal_algo_update_template_by_feature, uint8_t *,
			uint8_t *);

#endif /* PLATFORM_EC_ZEPHYR_TEST_FINGERPRINT_ALGORITHM_FT98XX_INCLUDE_FT98XX_ALGO_MOCKS_H_ \
	*/
```
