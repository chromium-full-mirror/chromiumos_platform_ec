/* Copyright 2026 The ChromiumOS Authors
 * Use of this source code is governed by a BSD-style license that can be
 * found in the LICENSE file.
 */

/ {
	named-gpios {
		/delete-node/ gpio_tp_en_od;
		gpio_tchscr_report_en: gpio_tchscr_report_en {
			gpios = <&gpiob 5 GPIO_OUTPUT_LOW>;
		};
	};
};
