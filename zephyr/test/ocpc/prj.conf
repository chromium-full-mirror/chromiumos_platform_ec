## prj.conf
```kconfig
# Copyright 2023 The ChromiumOS Authors
# Use of this source code is governed by a BSD-style license that can be
# found in the LICENSE file.

CONFIG_ZTEST=y
CONFIG_EMUL=y

# Basic EC functions
CONFIG_SHIMMED_TASKS=y
CONFIG_CROS_EC=y
CONFIG_PLATFORM_EC=y
CONFIG_PLATFORM_EC_HOOKS=y
CONFIG_PLATFORM_EC_HOSTCMD=y

# Unwanted features
CONFIG_PLATFORM_EC_VBOOT_HASH=n
CONFIG_PLATFORM_EC_BACKLIGHT_LID=n
CONFIG_PLATFORM_EC_USBC_PPC=n
CONFIG_PLATFORM_EC_USB_CHARGER=n

# Power and charger-related
CONFIG_PLATFORM_EC_POWER_BUTTON=y
CONFIG_PLATFORM_EC_CHARGER=y
CONFIG_PLATFORM_EC_OCPC=y
CONFIG_PLATFORM_EC_OCPC_DEF_RBATT_MOHMS=22
CONFIG_PLATFORM_EC_CHARGER_SENSE_RESISTOR=10
CONFIG_PLATFORM_EC_CHARGER_SENSE_RESISTOR_AC=10
CONFIG_PLATFORM_EC_USB_PD_DISCHARGE=n
CONFIG_PLATFORM_EC_USB_PD_5V_EN_CUSTOM=y
CONFIG_PLATFORM_EC_OCPC_DEF_DRIVELIMIT_MILLIVOLTS=200
CONFIG_PLATFORM_EC_I2C_VIRTUAL_BATTERY=y
CONFIG_PLATFORM_EC_CHARGER_RAA489000=y
CONFIG_PLATFORM_EC_USB_PD_TCPM_RAA489000=y
CONFIG_PLATFORM_EC_BATTERY_FUEL_GAUGE=y

# Console
CONFIG_SHELL_BACKEND_DUMMY=y
CONFIG_SHELL_BACKEND_SERIAL=n
CONFIG_SERIAL=y
```

## src/fakes.c
```c
/* Copyright 2023 The ChromiumOS Authors
 * Use of this source code is governed by a BSD-style license that can be
 * found in the LICENSE file.
 */

/* LCOV_EXCL_START - Test fakes */

int battery_is_present(void)
{
	return 1;
}

int board_set_active_charge_port(int port)
{
	return 0;
}

int pd_set_power_supply_ready(int port)
{
	return 0;
}

void pd_power_supply_reset(int port)
{
}

int board_is_sourcing_vbus(int port)
{
	return 0;
}

int pd_check_vconn_swap(int port)
{
	return 0;
}

int extpower_is_present(void)
{
	return 0;
}

int lid_is_open(void)
{
	return 0;
}

/* LCOV_EXCL_STOP */
```
