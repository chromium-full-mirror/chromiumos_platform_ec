## CMakeLists.txt
```
# Copyright 2022 The ChromiumOS Authors
# Use of this source code is governed by a BSD-style license that can be
# found in the LICENSE file.

cmake_minimum_required(VERSION 3.20.0)
find_package(Zephyr REQUIRED HINTS "${ZEPHYR_BASE}")
project(system_common_test)

# Include FFF fakes
add_subdirectory(${PLATFORM_EC}/zephyr/test/test_utils test_utils)

FILE(GLOB test_sources src/*.c)
target_sources(app PRIVATE ${test_sources})

if (DEFINED CONFIG_TEST_CORTEX_M_MPU)
	target_include_directories(app PRIVATE
		${PLATFORM_EC}/zephyr/shim/chip/npcx/include
	)
	target_sources(app PRIVATE
		${PLATFORM_EC}/zephyr/shim/core/cortex-m/mpu.c
	)
endif()
```

## Kconfig
```
# Copyright 2026 The ChromiumOS Authors
# Use of this source code is governed by a BSD-style license that can be
# found in the LICENSE file.

config TEST_SYSTEM_MPU
	bool "Enable MPU for system_common tests"
	default y
	select CPU_HAS_MPU
	select MPU

config TEST_CORTEX_M_MPU
	bool "Test Cortex-M MPU shim on native_sim"
	select ARM_MPU
	select NPCX_RAM_LOCK

source "Kconfig.zephyr"
```

## prj.conf
```kconfig
# Copyright 2022 The ChromiumOS Authors
# Use of this source code is governed by a BSD-style license that can be
# found in the LICENSE file.

CONFIG_ZTEST=y
CONFIG_CROS_EC=y

CONFIG_PLATFORM_EC_CROS_FWID_VERSION=y
CONFIG_PLATFORM_EC=y
CONFIG_PLATFORM_EC_BACKLIGHT_LID=n
CONFIG_PLATFORM_EC_HOSTCMD=y
CONFIG_PLATFORM_EC_LID_SWITCH=n
CONFIG_PLATFORM_EC_PANIC=n
CONFIG_PLATFORM_EC_SWITCH=n
CONFIG_PLATFORM_EC_VBOOT_HASH=n
CONFIG_SYSTEM_BOOT_TIME_LOGGING=y
CONFIG_TEST_UTILS_HOST_CMD_RESPONSE_TIMEOUT_MS=2000
```

## src/pulse_entering_rw.c
```c
/* Copyright 2026 The ChromiumOS Authors
 * Use of this source code is governed by a BSD-style license that can be
 * found in the LICENSE file.
 */

#include "gpio.h"
#include "gpio_signal.h"

#include <zephyr/drivers/gpio.h>
#include <zephyr/drivers/gpio/gpio_emul.h>
#include <zephyr/ztest.h>

void pulse_entering_rw(void);

static int high_transitions;
static int low_transitions;

static void entering_rw_callback(const struct device *port,
				 struct gpio_callback *cb,
				 gpio_port_pins_t pins)
{
	const struct gpio_dt_spec *spec = gpio_get_dt_spec(GPIO_ENTERING_RW);

	ARG_UNUSED(cb);
	ARG_UNUSED(pins);
	if (gpio_emul_output_get(port, spec->pin)) {
		high_transitions++;
	} else {
		low_transitions++;
	}
}

ZTEST(pulse_entering_rw, test_pulse_entering_rw)
{
	const struct gpio_dt_spec *spec = gpio_get_dt_spec(GPIO_ENTERING_RW);
	struct gpio_callback cb;

	zassert_not_null(spec, "GPIO_ENTERING_RW should be implemented");

	/* Initialize and add callback to detect pin state transitions */
	high_transitions = 0;
	low_transitions = 0;
	gpio_init_callback(&cb, entering_rw_callback, BIT(spec->pin));
	zassert_ok(gpio_add_callback(spec->port, &cb));

	/* Run pulse_entering_rw and verify behavior */
	pulse_entering_rw();

	/* Clean up callback */
	gpio_remove_callback(spec->port, &cb);

	/* Verify the pulse asserted high then deasserted low */
	zassert_equal(high_transitions, 1, "Expected 1 high transition, got %d",
		      high_transitions);
	zassert_equal(low_transitions, 1, "Expected 1 low transition, got %d",
		      low_transitions);
	zassert_equal(gpio_emul_output_get(spec->port, spec->pin), 0,
		      "GPIO_ENTERING_RW should be deasserted (0) after pulse");

	/* Preset high to verify pulse_entering_rw resets pin from high */
	zassert_ok(gpio_pin_set_dt(spec, 1));
	zassert_equal(gpio_emul_output_get(spec->port, spec->pin), 1);
	pulse_entering_rw();
	zassert_equal(gpio_emul_output_get(spec->port, spec->pin), 0,
		      "GPIO_ENTERING_RW should be deasserted (0) after pulse");
}

ZTEST_SUITE(pulse_entering_rw, NULL, NULL, NULL, NULL, NULL);
```

## src/reboot.c
```c
/* Copyright 2022 The ChromiumOS Authors
 * Use of this source code is governed by a BSD-style license that can be
 * found in the LICENSE file.
 */

#include "host_command.h"
#include "system.h"

#include <zephyr/device.h>
#include <zephyr/fff.h>
#include <zephyr/kernel.h>
#include <zephyr/ztest_assert.h>
#include <zephyr/ztest_test.h>

FAKE_VOID_FUNC(system_reset, int);
FAKE_VOID_FUNC(system_hibernate, uint32_t, uint32_t);

ZTEST_SUITE(console_cmd_reboot, NULL, NULL, NULL, NULL, NULL);

ZTEST(console_cmd_reboot, test_reboot_valid)
{
	int ret;
	int i;

	struct {
		char *cmd;
		int expect_called;
		int expect_flags;
	} tests[] = {
		{
			.cmd = "reboot hard",
			.expect_called = 1,
			.expect_flags = SYSTEM_RESET_MANUALLY_TRIGGERED |
					SYSTEM_RESET_HARD,
		},
		{
			.cmd = "reboot cold",
			.expect_called = 1,
			.expect_flags = SYSTEM_RESET_MANUALLY_TRIGGERED |
					SYSTEM_RESET_HARD,
		},
		{
			.cmd = "reboot soft",
			.expect_called = 1,
			.expect_flags = SYSTEM_RESET_MANUALLY_TRIGGERED,
		},
		{
			.cmd = "reboot ap-off",
			.expect_called = 1,
			.expect_flags = SYSTEM_RESET_MANUALLY_TRIGGERED |
					SYSTEM_RESET_LEAVE_AP_OFF,
		},
		{
			.cmd = "reboot ap-off-in-ro",
			.expect_called = 1,
			.expect_flags = SYSTEM_RESET_MANUALLY_TRIGGERED |
					SYSTEM_RESET_LEAVE_AP_OFF |
					SYSTEM_RESET_STAY_IN_RO,
		},
		{
			.cmd = "reboot ro",
			.expect_called = 1,
			.expect_flags = SYSTEM_RESET_MANUALLY_TRIGGERED |
					SYSTEM_RESET_STAY_IN_RO,
		},
		{
			.cmd = "reboot cancel",
			.expect_called = 0,
			.expect_flags = 0,
		},
		{
			.cmd = "reboot preserve",
			.expect_called = 1,
			.expect_flags = SYSTEM_RESET_MANUALLY_TRIGGERED |
					SYSTEM_RESET_PRESERVE_FLAGS,
		},
		{
			.cmd = "reboot wait-ext",
			.expect_called = 1,
			.expect_flags = SYSTEM_RESET_MANUALLY_TRIGGERED |
					SYSTEM_RESET_WAIT_EXT,
		},
	};

	for (i = 0; i < ARRAY_SIZE(tests); i++) {
		char *cmd = tests[i].cmd;

		RESET_FAKE(system_reset);
		RESET_FAKE(system_hibernate);

		ret = shell_execute_cmd(get_ec_shell(), cmd);

		zassert_equal(ret, EC_SUCCESS,
			      "Unexpected return value for '%s': %d", cmd, ret);
		zassert_equal(system_reset_fake.call_count,
			      tests[i].expect_called,
			      "Unexpected call count for '%s': %d", cmd,
			      system_reset_fake.call_count);
		zassert_equal(system_reset_fake.arg0_history[0],
			      tests[i].expect_flags,
			      "Unexpected flags for '%s': %x", cmd,
			      system_reset_fake.arg0_history[0]);
	}
}

ZTEST(console_cmd_reboot, test_reboot_invalid)
{
	int ret;

	ret = shell_execute_cmd(get_ec_shell(), "reboot i-am-not-an-argument");

	zassert_equal(ret, EC_ERROR_PARAM1, "invalid return value: %d", ret);
	zassert_equal(system_reset_fake.call_count, 0,
		      "Unexpected call count: %d",
		      system_reset_fake.call_count);
}

ZTEST_SUITE(host_cmd_reboot, NULL, NULL, NULL, NULL, NULL);

ZTEST(host_cmd_reboot, test_reboot)
{
	int ret;
	int i;
	struct ec_params_reboot_ec p;
	int reboot_at_shutdown;

	struct {
		uint8_t cmd;
		uint8_t flags;
		int expect_return;
		int expect_reboot_at_shutdown;
		int expect_reset_called;
		int expect_reset_flags;
		int expect_hibernate_called;
	} tests[] = {
		{
			.cmd = EC_REBOOT_CANCEL,
			.flags = 0,
			.expect_return = EC_RES_SUCCESS,
			.expect_reboot_at_shutdown = EC_REBOOT_CANCEL,
			.expect_reset_called = 0,
			.expect_reset_flags = 0,
			.expect_hibernate_called = 0,
		},
		{
			.cmd = EC_REBOOT_COLD,
			.flags = EC_REBOOT_FLAG_SWITCH_RW_SLOT,
			.expect_return = EC_RES_INVALID_PARAM,
			.expect_reboot_at_shutdown = 0,
			.expect_reset_called = 0,
			.expect_reset_flags = 0,
			.expect_hibernate_called = 0,
		},
		{
			.cmd = 0xaa, /* cmd passed unmodified */
			.flags = EC_REBOOT_FLAG_ON_AP_SHUTDOWN,
			.expect_return = EC_RES_SUCCESS,
			.expect_reboot_at_shutdown = 0xaa,
			.expect_reset_called = 0,
			.expect_reset_flags = 0,
			.expect_hibernate_called = 0,
		},
		{
			.cmd = 0x55, /* cmd passed unmodified */
			.flags = EC_REBOOT_FLAG_ON_AP_SHUTDOWN,
			.expect_return = EC_RES_SUCCESS,
			.expect_reboot_at_shutdown = 0x55,
			.expect_reset_called = 0,
			.expect_reset_flags = 0,
			.expect_hibernate_called = 0,
		},
		{
			.cmd = EC_REBOOT_COLD,
			.flags = 0,
			.expect_return = IS_ENABLED(CONFIG_EC_HOST_CMD) ?
						 EC_RES_SUCCESS :
						 EC_RES_ERROR,
			.expect_reboot_at_shutdown = EC_REBOOT_CANCEL,
			.expect_reset_called = 1,
			.expect_reset_flags = SYSTEM_RESET_HARD,
			.expect_hibernate_called = 0,
		},
		{
			.cmd = EC_REBOOT_HIBERNATE,
			.flags = 0,
			.expect_return = IS_ENABLED(CONFIG_EC_HOST_CMD) ?
						 EC_RES_SUCCESS :
						 EC_RES_ERROR,
			.expect_reboot_at_shutdown = EC_REBOOT_CANCEL,
			.expect_reset_called = 0,
			.expect_reset_flags = 0,
			.expect_hibernate_called = 1,
		},
		{
			.cmd = EC_REBOOT_COLD_AP_OFF,
			.flags = 0,
			.expect_return = IS_ENABLED(CONFIG_EC_HOST_CMD) ?
						 EC_RES_SUCCESS :
						 EC_RES_ERROR,
			.expect_reboot_at_shutdown = EC_REBOOT_CANCEL,
			.expect_reset_called = 1,
			.expect_reset_flags = SYSTEM_RESET_HARD |
					      SYSTEM_RESET_LEAVE_AP_OFF,
			.expect_hibernate_called = 0,
		},
		{
			.cmd = 0xff,
			.flags = 0,
			.expect_return = EC_RES_INVALID_PARAM,
			.expect_reboot_at_shutdown = EC_REBOOT_CANCEL,
			.expect_reset_called = 0,
			.expect_reset_flags = 0,
			.expect_hibernate_called = 0,
		},
	};

	for (i = 0; i < ARRAY_SIZE(tests); i++) {
		p.cmd = tests[i].cmd;
		p.flags = tests[i].flags;

		RESET_FAKE(system_reset);
		RESET_FAKE(system_hibernate);

		ret = ec_cmd_reboot_ec(NULL, &p);

		/* Give time for mocked functions to run */
		if (IS_ENABLED(CONFIG_EC_HOST_CMD) && ret == EC_RES_SUCCESS &&
		    (p.cmd == EC_REBOOT_COLD ||
		     p.cmd == EC_REBOOT_COLD_AP_OFF ||
		     p.cmd == EC_REBOOT_HIBERNATE)) {
			k_msleep(p.cmd == EC_REBOOT_HIBERNATE ? 2000 : 100);
		}

		zassert_equal(ret, tests[i].expect_return,
			      "Unexpected return value (%d): %d", i, ret);
		reboot_at_shutdown =
			system_common_get_reset_reboot_at_shutdown();
		zassert_equal(
			reboot_at_shutdown, tests[i].expect_reboot_at_shutdown,
			"Unexpected value for reboot_at_shutdown (%d): %d", i,
			reboot_at_shutdown);
		zassert_equal(system_reset_fake.call_count,
			      tests[i].expect_reset_called,
			      "Unexpected reset call count (%d): %d", i,
			      system_reset_fake.call_count);
		zassert_equal(system_reset_fake.arg0_history[0],
			      tests[i].expect_reset_flags,
			      "Unexpected flags (%d): %x", i,
			      system_reset_fake.arg0_history[0]);
		zassert_equal(system_hibernate_fake.call_count,
			      tests[i].expect_hibernate_called,
			      "Unexpected hibernate call count (%d): %d", i,
			      system_hibernate_fake.call_count);
	}
}

ZTEST_SUITE(console_cmd_hibernate, NULL, NULL, NULL, NULL, NULL);

int chipset_in_state(int state_mask)
{
	return 0;
}

ZTEST(console_cmd_hibernate, test_hibernate_default)
{
	int ret;

	RESET_FAKE(system_hibernate);

	ret = shell_execute_cmd(get_ec_shell(), "hibernate");

	zassert_equal(ret, EC_SUCCESS, "Unexpected return value: %d", ret);
	zassert_equal(system_hibernate_fake.call_count, 1,
		      "Unexpected hibernate call count: %d",
		      system_hibernate_fake.call_count);
	zassert_equal(system_hibernate_fake.arg0_history[0], 0,
		      "Unexpected hibernate_secondst: %d",
		      system_hibernate_fake.arg0_history[0]);
	zassert_equal(system_hibernate_fake.arg1_history[0], 0,
		      "Unexpected hibernate_secondst: %d",
		      system_hibernate_fake.arg1_history[0]);
}

ZTEST(console_cmd_hibernate, test_hibernate_args)
{
	int ret;

	RESET_FAKE(system_hibernate);

	ret = shell_execute_cmd(get_ec_shell(), "hibernate 123 456");

	zassert_equal(ret, EC_SUCCESS, "Unexpected return value: %d", ret);
	zassert_equal(system_hibernate_fake.call_count, 1,
		      "Unexpected hibernate call count: %d",
		      system_hibernate_fake.call_count);
	zassert_equal(system_hibernate_fake.arg0_history[0], 123,
		      "Unexpected hibernate_secondst: %d",
		      system_hibernate_fake.arg0_history[0]);
	zassert_equal(system_hibernate_fake.arg1_history[0], 456,
		      "Unexpected hibernate_secondst: %d",
		      system_hibernate_fake.arg1_history[0]);
}
```

## src/system_is_locked.c
```c
/* Copyright 2022 The ChromiumOS Authors
 * Use of this source code is governed by a BSD-style license that can be
 * found in the LICENSE file.
 */

#include "mpu.h"
#if defined(CONFIG_TEST_CORTEX_M_MPU)
#include "ram_lock.h"
#endif
#include "system.h"

#include <zephyr/fff.h>
#include <zephyr/shell/shell_dummy.h>
#include <zephyr/ztest_assert.h>
#include <zephyr/ztest_test.h>

#if defined(CONFIG_TEST_CORTEX_M_MPU)
static const struct arm_mpu_region test_mpu_regions[] = {
	{ .base = CONFIG_FLASH_BASE_ADDRESS },
	{ .base = CONFIG_SRAM_BASE_ADDRESS },
	{ .base = 0 },
};

const struct arm_mpu_config mpu_config = {
	.num_regions = ARRAY_SIZE(test_mpu_regions),
	.mpu_regions = test_mpu_regions,
};

FAKE_VALUE_FUNC(int, ram_lock_config_lock_region, uint8_t, uint32_t, uint32_t);
#else
FAKE_VOID_FUNC(mpu_enable);
#endif

ZTEST_USER(system_is_locked, test_syslock_console_cmd)
{
	/*
	 * Integration test that validates the syslock console command forces
	 * the system_is_locked command to return true
	 */

	const struct shell *shell_zephyr = get_ec_shell();

	shell_backend_dummy_clear_output(shell_zephyr);
#if defined(CONFIG_TEST_CORTEX_M_MPU)
	RESET_FAKE(ram_lock_config_lock_region);
#else
	RESET_FAKE(mpu_enable);
#endif

	zassert_false(system_is_locked());

#if defined(CONFIG_TEST_CORTEX_M_MPU)
	test_mpu_regs.RASR = 0;
	system_disable_jump();
	zassert_equal(ram_lock_config_lock_region_fake.call_count, 0);
	zassert_true(test_mpu_regs.RASR & MPU_RASR_ENABLE_Msk);

	arch_pre_system_jump();
	zassert_false(test_mpu_regs.RASR & MPU_RASR_ENABLE_Msk);
#else
	system_disable_jump();
	zassert_equal(mpu_enable_fake.call_count, 1);
#endif

	/*
	 * TODO(b/249373175): Use CHECK_CONSOLE_CMD() macro
	 */
	zassert_ok(shell_execute_cmd(shell_zephyr, "syslock"), NULL);
	zassert_true(system_is_locked());

#if defined(CONFIG_TEST_CORTEX_M_MPU)
	test_mpu_regs.RASR = 0;
	system_disable_jump();
	zassert_equal(ram_lock_config_lock_region_fake.call_count, 2);
	zassert_equal(ram_lock_config_lock_region_fake.arg0_history[0],
		      REGION_STORAGE);
	zassert_equal(ram_lock_config_lock_region_fake.arg1_history[0],
		      CONFIG_FLASH_BASE_ADDRESS);
	zassert_equal(ram_lock_config_lock_region_fake.arg2_history[0],
		      (CONFIG_FLASH_SIZE << 10));

	zassert_equal(ram_lock_config_lock_region_fake.arg0_history[1],
		      REGION_DATA_RAM);
	zassert_equal(ram_lock_config_lock_region_fake.arg1_history[1],
		      CONFIG_SRAM_BASE_ADDRESS);
	zassert_equal(ram_lock_config_lock_region_fake.arg2_history[1],
		      (CONFIG_SRAM_SIZE << 10));
	zassert_true(test_mpu_regs.RASR & MPU_RASR_ENABLE_Msk);
#else
	RESET_FAKE(mpu_enable);
	system_disable_jump();
	zassert_equal(mpu_enable_fake.call_count, 1);
#endif
}

ZTEST_SUITE(system_is_locked, NULL, NULL, NULL, NULL, NULL);
```
