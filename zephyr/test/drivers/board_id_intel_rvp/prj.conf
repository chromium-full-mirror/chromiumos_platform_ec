## CMakeLists.txt
```
# Copyright 2026 The ChromiumOS Authors
# Use of this source code is governed by a BSD-style license that can be
# found in the LICENSE file.

cmake_minimum_required(VERSION 3.13.1)
find_package(Zephyr REQUIRED HINTS "${ZEPHYR_BASE}")
project(board_id_intel_rvp)

target_sources(app PRIVATE
	${PLATFORM_EC}/zephyr/drivers/board_id/board_id_intel_rvp.c)

# Shared helpers and fakes used by every board-id test suite.
target_sources(app PRIVATE src/board_id_test_common.c)

target_sources_ifdef(CONFIG_LINK_TEST_SUITE_BOARD_ID_INTEL_RVP
	app PRIVATE src/board_id_intel_rvp.c)
target_sources_ifdef(CONFIG_LINK_TEST_SUITE_BOARD_ID_INTEL_RVP_NOT_READY
	app PRIVATE src/board_id_not_ready.c)
target_sources_ifdef(CONFIG_LINK_TEST_SUITE_BOARD_ID_INTEL_RVP_S5_CALLBACK
	app PRIVATE src/board_id_s5_callback.c)
```

## Kconfig
```
# Copyright 2026 The ChromiumOS Authors
# Use of this source code is governed by a BSD-style license that can be
# found in the LICENSE file.

config LINK_TEST_SUITE_BOARD_ID_INTEL_RVP
	bool "Link the board_id_intel_rvp test suite"
	help
	  Test suite that exercises the RVP board-id driver with the
	  strap GPIO controller initialized.

config LINK_TEST_SUITE_BOARD_ID_INTEL_RVP_NOT_READY
	bool "Link the board_id_intel_rvp not-ready test suite"
	help
	  Test suite that exercises the RVP board-id driver while the
	  deferred strap GPIO controller is intentionally left uninitialized.

config LINK_TEST_SUITE_BOARD_ID_INTEL_RVP_S5_CALLBACK
	bool "Link the board_id_intel_rvp S5-callback test suite"
	help
	  Test suite that verifies the driver's S5-exit callback
	  initializes the deferred strap GPIO controller.

source "Kconfig.zephyr"
```

## prj.conf
```kconfig
# Copyright 2026 The ChromiumOS Authors
# Use of this source code is governed by a BSD-style license that can be
# found in the LICENSE file.

CONFIG_ZTEST=y
CONFIG_ZTEST_ASSERT_VERBOSE=1
CONFIG_ASSERT=y

CONFIG_GPIO=y
CONFIG_GPIO_EMUL=y

CONFIG_LOG=y

CONFIG_CROS_EC=y
CONFIG_PLATFORM_EC=y
CONFIG_SHIMMED_TASKS=y

CONFIG_AP_PWRSEQ=y
CONFIG_AP_PWRSEQ_DRIVER=y
CONFIG_EMUL_AP_PWRSEQ_DRIVER=y
CONFIG_AP_X86_INTEL_MTL=y

# The CBI model-id accessors are faked by the test
CONFIG_PLATFORM_EC_CBI=n

CONFIG_PLATFORM_EC_LID_SWITCH=n
CONFIG_PLATFORM_EC_SWITCH=n
CONFIG_PLATFORM_EC_BACKLIGHT_LID=n
CONFIG_PLATFORM_EC_VBOOT_HASH=n
CONFIG_PLATFORM_EC_VBOOT_EFS2=n
CONFIG_PLATFORM_EC_VSTORE=n
```

## boards/native_sim.overlay
```dts
/* Copyright 2026 The ChromiumOS Authors
 * Use of this source code is governed by a BSD-style license that can be
 * found in the LICENSE file.
 */

#include <board-overlays/native_sim.dts>

/ {
	common-pwrseq {
		compatible = "intel,ap-pwrseq";
	};

	/*
	 * GPIO emulator that drives the RVP board ID straps. It is marked
	 * zephyr,deferred-init so it starts NOT ready (mirroring a real I/O
	 * expander that is only powered up when the AP leaves S5); the driver's
	 * S5 exit callback then calls device_init() on it.
	 */
	rvp_id_gpio: gpio@9a00 {
		status = "okay";
		compatible = "zephyr,gpio-emul";
		reg = <0x9a00 0x4>;
		rising-edge;
		falling-edge;
		high-level;
		low-level;
		gpio-controller;
		#gpio-cells = <2>;
		ngpios = <16>;
		zephyr,deferred-init;
	};

	rvp_board_id: rvp-board-id {
		compatible = "intel,rvp-board-id";
		zephyr,deferred-init;

		/*
		 * The GPIO pin assignments below must be kept in sync with the
		 * test code that drives these straps.
		 */

		/* BOM ID [2:0] : pins 8, 9, 10 */
		bom-gpios = <&rvp_id_gpio 8 0>, <&rvp_id_gpio 9 0>,
			    <&rvp_id_gpio 10 0>;

		/* FAB ID [1:0] : pins 6, 7 */
		fab-gpios = <&rvp_id_gpio 6 0>, <&rvp_id_gpio 7 0>;

		/* BOARD ID [5:0] : pins 0..5 */
		board-gpios = <&rvp_id_gpio 0 0>, <&rvp_id_gpio 1 0>,
			      <&rvp_id_gpio 2 0>, <&rvp_id_gpio 3 0>,
			      <&rvp_id_gpio 4 0>, <&rvp_id_gpio 5 0>;

		defer-until-s5 = <&rvp_id_gpio>;
		handler = "rvp_id_handler";
	};
};
```

## src/board_id_intel_rvp.c
```c
/* Copyright 2026 The ChromiumOS Authors
 * Use of this source code is governed by a BSD-style license that can be
 * found in the LICENSE file.
 */

#include "board_id_test_common.h"

#include <zephyr/device.h>
#include <zephyr/ztest.h>

#include <ap_power/ap_pwrseq.h>
#include <drivers/rvp_board_id.h>

ZTEST(board_id_intel_rvp, test_board_get_version)
{
	/* CBI has no model id yet: board_get_version() reports an error. */
	cbi_get_model_id_fake.return_val = EC_ERROR_UNKNOWN;
	zassert_equal(board_get_version(), -1);

	/* CBI now provides a model id, it is cached and the board id returned.
	 */
	cbi_model_id_value = 0x22a;
	cbi_get_model_id_fake.custom_fake = cbi_get_model_id_match;
	zassert_equal(board_get_version(), 0x22a & BOARD_ID_MASK);
}

ZTEST(board_id_intel_rvp, test_get_rvp_id_config_board_id)
{
	set_board_gpios(0x2a);

	zassert_equal(get_rvp_id_config(BOARD_ID), 0x2a);
}

ZTEST(board_id_intel_rvp, test_get_rvp_id_config_fab_id)
{
	set_fab_gpios(0x1);

	zassert_equal(get_rvp_id_config(FAB_ID), 2);
}

ZTEST(board_id_intel_rvp, test_get_rvp_id_config_bom_id)
{
	set_bom_gpios(0x3);

	zassert_equal(get_rvp_id_config(BOM_ID), 3);
}

ZTEST(board_id_intel_rvp, test_get_rvp_id_config_invalid)
{
	zassert_equal(get_rvp_id_config((enum rvp_id_type)0xff), -1);
}

ZTEST(board_id_intel_rvp, test_rvp_id_handler_stores_in_cbi)
{
	set_board_gpios(0x2a);
	set_fab_gpios(0x1);

	/* CBI read fails, so the freshly computed model id is written back. */
	cbi_get_model_id_fake.return_val = EC_ERROR_UNKNOWN;

	rvp_id_handler();

	zassert_equal(cbi_set_model_id_fake.call_count, 1);
	zassert_equal(cbi_set_model_id_fake.arg0_val,
		      (2 << FAB_ID_SHIFT) | 0x2a);

	/*
	 * After the handler caches the model id, board_get_version() returns
	 * only the board id portion without consulting CBI again.
	 */
	zassert_equal(board_get_version(), 0x2a & BOARD_ID_MASK);
}

ZTEST(board_id_intel_rvp, test_rvp_id_handler_cbi_up_to_date)
{
	set_board_gpios(0x2a);
	set_fab_gpios(0x1);

	/* CBI already holds the same model id, nothing is written. */
	cbi_model_id_value = (2 << FAB_ID_SHIFT) | 0x2a;
	cbi_get_model_id_fake.custom_fake = cbi_get_model_id_match;

	rvp_id_handler();

	zassert_equal(cbi_set_model_id_fake.call_count, 0);
}

ZTEST(board_id_intel_rvp, test_rvp_id_handler_cbi_mismatch)
{
	set_board_gpios(0x2a);
	set_fab_gpios(0x1);

	/* CBI holds a stale model id, so it is refreshed. */
	cbi_model_id_value = 0x999;
	cbi_get_model_id_fake.custom_fake = cbi_get_model_id_match;

	rvp_id_handler();

	zassert_equal(cbi_set_model_id_fake.call_count, 1);
	zassert_equal(cbi_set_model_id_fake.arg0_val,
		      (2 << FAB_ID_SHIFT) | 0x2a);
}

ZTEST(board_id_intel_rvp, test_rvp_id_handler_cbi_set_fails)
{
	set_board_gpios(0x2a);
	set_fab_gpios(0x1);

	/* CBI read fails, so a write is attempted, but the write fails too. */
	cbi_get_model_id_fake.return_val = EC_ERROR_UNKNOWN;
	cbi_set_model_id_fake.return_val = EC_ERROR_UNKNOWN;

	rvp_id_handler();

	zassert_equal(cbi_set_model_id_fake.call_count, 1);
	zassert_equal(cbi_set_model_id_fake.arg0_val,
		      (2 << FAB_ID_SHIFT) | 0x2a);
}

ZTEST(board_id_intel_rvp, test_s5_exit_callback_runs_handler)
{
	set_board_gpios(0x2a);
	set_fab_gpios(0x1);

	/* CBI has no model id yet, so the handler writes the computed one. */
	cbi_get_model_id_fake.return_val = EC_ERROR_UNKNOWN;

	/*
	 * Exiting S5 into a higher-power state (S3 > S5) triggers the driver
	 * callback, which initializes the strap GPIOs and runs the handler.
	 */
	send_ap_pwrseq_s5_exit(AP_POWER_STATE_S3);

	zassert_equal(cbi_set_model_id_fake.call_count, 1);
	zassert_equal(cbi_set_model_id_fake.arg0_val,
		      (2 << FAB_ID_SHIFT) | 0x2a);
}

static void board_id_intel_rvp_before(void *fixture)
{
	ARG_UNUSED(fixture);

	board_id_intel_rvp_reset();

	/*
	 * These tests read known strap values, so make sure the deferred strap
	 * controller is initialized before each test. Doing it here keeps the
	 * per-test helpers free of setup logic.
	 */
	ensure_straps_ready();
}

ZTEST_SUITE(board_id_intel_rvp, NULL, NULL, board_id_intel_rvp_before, NULL,
	    NULL);
```

## src/board_id_not_ready.c
```c
/* Copyright 2026 The ChromiumOS Authors
 * Use of this source code is governed by a BSD-style license that can be
 * found in the LICENSE file.
 */

#include "board_id_test_common.h"

#include <errno.h>

#include <zephyr/device.h>
#include <zephyr/ztest.h>

#include <drivers/rvp_board_id.h>

ZTEST(board_id_intel_rvp_not_ready, test_board_id_config_not_ready)
{
	/* The GPIO controller is not ready: report a device error. */
	zassert_equal(get_rvp_id_config(BOARD_ID), -ENODEV);
}

ZTEST(board_id_intel_rvp_not_ready, test_board_id_handler_not_ready)
{
	/*
	 * With the straps unavailable the handler cannot read the board id, so
	 * it bails out without writing CBI.
	 */
	rvp_id_handler();

	zassert_equal(cbi_set_model_id_fake.call_count, 0);
}

static void board_id_intel_rvp_not_ready_before(void *fixture)
{
	ARG_UNUSED(fixture);

	board_id_intel_rvp_reset();

	/*
	 * These tests exercise the device-not-ready paths, so the deferred
	 * strap controller is intentionally left uninitialized. Keeping them in
	 * their own binary guarantees no other test initializes it first.
	 */
	zassert_false(device_is_ready(rvp_gpio_dev));
}

ZTEST_SUITE(board_id_intel_rvp_not_ready, NULL, NULL,
	    board_id_intel_rvp_not_ready_before, NULL, NULL);
```

## src/board_id_s5_callback.c
```c
/* Copyright 2026 The ChromiumOS Authors
 * Use of this source code is governed by a BSD-style license that can be
 * found in the LICENSE file.
 */

#include "board_id_test_common.h"

#include <zephyr/device.h>
#include <zephyr/ztest.h>

#include <ap_power/ap_pwrseq.h>

ZTEST(board_id_intel_rvp_s5_callback, test_callback_inits_deferred_gpios)
{
	/* Avoid an uninitialized CBI read inside the handler. */
	cbi_get_model_id_fake.return_val = EC_ERROR_UNKNOWN;

	/* Exiting S5 into a higher-power state (S3 > S5) runs the callback. */
	send_ap_pwrseq_s5_exit(AP_POWER_STATE_S3);

	/* The callback called device_init() on the strap controller. */
	zassert_true(device_is_ready(rvp_gpio_dev));
}

static void board_id_intel_rvp_s5_callback_before(void *fixture)
{
	ARG_UNUSED(fixture);

	board_id_intel_rvp_reset();

	/*
	 * This suite verifies that the S5-exit callback initializes the
	 * deferred strap controller, so it must start not-ready. Because the
	 * test mutates that state, it lives in its own binary to stay
	 * independent of test execution order.
	 */
	zassert_false(device_is_ready(rvp_gpio_dev));
}

ZTEST_SUITE(board_id_intel_rvp_s5_callback, NULL, NULL,
	    board_id_intel_rvp_s5_callback_before, NULL, NULL);
```

## src/board_id_test_common.c
```c
/* Copyright 2026 The ChromiumOS Authors
 * Use of this source code is governed by a BSD-style license that can be
 * found in the LICENSE file.
 */

#include "board_id_test_common.h"
#include "cros_board_info.h"

#include <stdint.h>

#include <zephyr/device.h>
#include <zephyr/devicetree.h>
#include <zephyr/drivers/gpio.h>
#include <zephyr/drivers/gpio/gpio_emul.h>
#include <zephyr/fff.h>
#include <zephyr/kernel.h>
#include <zephyr/logging/log.h>
#include <zephyr/ztest.h>

#include <ap_power/ap_pwrseq.h>
#include <ap_power/ap_pwrseq_sm.h>
#include <drivers/rvp_board_id.h>

LOG_MODULE_REGISTER(rvp_model_id, LOG_LEVEL_DBG);

/* Pin assignments, must match boards/native_sim.overlay. */
#define BOARD_PIN_BASE 0
#define FAB_PIN_BASE 6
#define BOM_PIN_BASE 8

DEFINE_FFF_GLOBALS;

DEFINE_FAKE_VALUE_FUNC(int, cbi_get_model_id, uint32_t *);
DEFINE_FAKE_VALUE_FUNC(int, cbi_set_model_id, uint32_t);

/*
 * The emulated AP power-sequence driver does not provide
 * get_ap_pwrseq_thread(), but the task shim references it. Supply a stub; the
 * task-mapping path that uses it is never exercised by these tests.
 */
k_tid_t get_ap_pwrseq_thread(void)
{
	return NULL;
}

#define RVP_GPIO_NODE DT_NODELABEL(rvp_id_gpio)

const struct device *const rvp_gpio_dev = DEVICE_DT_GET(RVP_GPIO_NODE);

/* Shared state used by the cbi_get_model_id custom fake. */
uint32_t cbi_model_id_value;

int cbi_get_model_id_match(uint32_t *id)
{
	*id = cbi_model_id_value;
	return EC_SUCCESS;
}

/*
 * The strap controller is deferred, so initialize it on demand for the suites
 * that read known strap values. This is a no-op once it is ready.
 */
void ensure_straps_ready(void)
{
	if (!device_is_ready(rvp_gpio_dev)) {
		zassert_ok(device_init(rvp_gpio_dev));
	}
}

void set_board_gpios(uint32_t board_id)
{
	for (int i = 0; i < BOARD_GPIOS_COUNT; i++) {
		zassert_ok(gpio_emul_input_set(rvp_gpio_dev, BOARD_PIN_BASE + i,
					       (board_id >> i) & 1));
	}
}

void set_fab_gpios(uint32_t raw_fab)
{
	for (int i = 0; i < FAB_GPIOS_COUNT; i++) {
		zassert_ok(gpio_emul_input_set(rvp_gpio_dev, FAB_PIN_BASE + i,
					       (raw_fab >> i) & 1));
	}
}

void set_bom_gpios(uint32_t bom_id)
{
	for (int i = 0; i < BOM_GPIOS_COUNT; i++) {
		zassert_ok(gpio_emul_input_set(rvp_gpio_dev, BOM_PIN_BASE + i,
					       (bom_id >> i) & 1));
	}
}

void send_ap_pwrseq_s5_exit(enum ap_pwrseq_state entry)
{
	STRUCT_SECTION_FOREACH(ap_pwrseq_state_cb, cb)
	{
		if (!cb->is_entry &&
		    (cb->states_bit_mask & BIT(AP_POWER_STATE_S5))) {
			cb->cb(NULL, entry, AP_POWER_STATE_S5);
		}
	}
}

void board_id_intel_rvp_reset(void)
{
	RESET_FAKE(cbi_get_model_id);
	RESET_FAKE(cbi_set_model_id);

	cbi_model_id_value = 0;

	/*
	 * The strap controller is deferred. Once a suite's setup (or the
	 * driver's S5 callback) has initialized it, reset its pins to a known
	 * state. Suites that exercise the not-ready paths never initialize it.
	 */
	if (device_is_ready(rvp_gpio_dev)) {
		for (int pin = 0; pin < 16; pin++) {
			zassert_ok(gpio_pin_configure(rvp_gpio_dev, pin,
						      GPIO_INPUT));
			zassert_ok(gpio_emul_input_set(rvp_gpio_dev, pin, 0));
		}
	}
}
```

## src/board_id_test_common.h
```c
/* Copyright 2026 The ChromiumOS Authors
 * Use of this source code is governed by a BSD-style license that can be
 * found in the LICENSE file.
 */

#ifndef PLATFORM_EC_ZEPHYR_TEST_DRIVERS_BOARD_ID_INTEL_RVP_SRC_BOARD_ID_TEST_COMMON_H_
#define PLATFORM_EC_ZEPHYR_TEST_DRIVERS_BOARD_ID_INTEL_RVP_SRC_BOARD_ID_TEST_COMMON_H_

#include "cros_board_info.h"

#include <stdint.h>

#include <zephyr/device.h>
#include <zephyr/fff.h>

#include <ap_power/ap_pwrseq.h>
#include <drivers/rvp_board_id.h>

DECLARE_FAKE_VALUE_FUNC(int, cbi_get_model_id, uint32_t *);
DECLARE_FAKE_VALUE_FUNC(int, cbi_set_model_id, uint32_t);

void rvp_id_handler(void);
int board_get_version(void);

/* Emulated strap GPIO controller shared by the board-id test suites. */
extern const struct device *const rvp_gpio_dev;

/* Shared state consumed by cbi_get_model_id_match(). */
extern uint32_t cbi_model_id_value;

/* Custom fake returning cbi_model_id_value as the CBI model id. */
int cbi_get_model_id_match(uint32_t *id);

/* Drive the emulated strap GPIOs for each identifier. */
void set_board_gpios(uint32_t board_id);
void set_fab_gpios(uint32_t raw_fab);
void set_bom_gpios(uint32_t bom_id);

/*
 * Initialize the deferred strap controller if it is not ready yet. This is a
 * no-op once the controller has been initialized.
 */
void ensure_straps_ready(void);

/* Invoke the driver's registered S5-exit callbacks. */
void send_ap_pwrseq_s5_exit(enum ap_pwrseq_state entry);

/* Reset the fakes and, when the straps are ready, their pins before a test. */
void board_id_intel_rvp_reset(void);

#endif /* PLATFORM_EC_ZEPHYR_TEST_DRIVERS_BOARD_ID_INTEL_RVP_SRC_BOARD_ID_TEST_COMMON_H_ \
	*/
```
