## zephyr/app/ec/chip/riscv/riscv-ite/Kconfig.ite
```kconfig
# Copyright 2025 The ChromiumOS Authors
# Use of this source code is governed by a BSD-style license that can be
# found in the LICENSE file.

if SOC_FAMILY_ITE_EC

# Power management options
config PM
	default y

config PM_DEVICE
	default y

choice PM_POLICY
	default PM_POLICY_CUSTOM
endchoice

endif # SOC_FAMILY_ITE_EC
```
