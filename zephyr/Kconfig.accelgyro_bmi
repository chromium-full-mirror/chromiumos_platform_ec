## zephyr/Kconfig.svdm_rsp
```kconfig
# Copyright 2022 The ChromiumOS Authors
# Use of this source code is governed by a BSD-style license that can be
# found in the LICENSE file.

if PLATFORM_EC_USB_POWER_DELIVERY

choice SVDM_RSP_CHOICE
	prompt "SVDM handler implementation"
	# Default value is the first listed choice that has satisfied
	# dependencies: this defaults to DFP_ONLY if possible.
	help
	  Select how USB-PD Structured Vendor Defined Messages (SVDM) will be
	  handled.

config PLATFORM_EC_SVDM_RSP
	bool "SVDM Response Support"
	help
	  Respond to Structured VDM requests using the common
	  SVDM response implementation.

	  The SVDM response indicates the device has
	  Type-C receptacles and supports USB 3.2 including USB4 and
	  Thunderbolt(TBT) support when enabled by platform configuration.

config SVDM_RSP_CUSTOM
	bool "Custom"
	help
	  The application defines SVDM handler functions appropriate to its
	  feature set by populating fields of the svdm_rsp struct:

	      __override const struct svdm_response svdm_rsp = { ... };

	  If any pointer in this struct is NULL, that command is unsupported:
	  matching SVDM commands that are received will be ignored and a
	  Not_Supported reply sent if required. If no definition __overrides
	  the default, all SVDM commands are treated as unsupported.

endchoice
endif  # PLATFORM_EC_USB_POWER_DELIVERY
```

## zephyr/Kconfig.throttle_ap
```kconfig
# Copyright 2021 The ChromiumOS Authors
# Use of this source code is governed by a BSD-style license that can be
# found in the LICENSE file.

config PLATFORM_EC_THROTTLE_AP
	bool "CPU throttling"
	help
	  Enable throttling the CPU. When triggered this reduces the CPU's
	  power output and eventually results in a lower temperature.

if PLATFORM_EC_THROTTLE_AP

config PLATFORM_EC_CHIPSET_CAN_THROTTLE
	bool "CPU can support throttling"
	default y
	help
	  Indicates that the SoC supports throttling. This means that a
	  chipset_throttle_cpu() function is provided by the chipset, to be
	  called to set the throttle state. The typical implementation asserts
	  GPIO_CPU_PROCHOT, to make the CPU slow down.

config PLATFORM_EC_CONSOLE_CMD_APTHROTTLE
	bool "Console command: apthrottle"
	default y
	help
	  This command shows the current status of AP throttling. Both soft
	  (type 0) and hard (type 1) throttling are supported. Soft throttling
	  is typically controlled by the AP via a host event. Hard throttling
	  typically uses the PROCHOT (Processor Hot) signal on x86 CPUs.

	  Example output:

	     AP throttling type 0 is off (0x00000000)
	     AP throttling type 1 is off (0x00000000)

config PLATFORM_EC_THROTTLE_AP_SINGLE_PIN
	bool "CPU throttling and interrupt detection on a single pin"
	help
	  Enable detection of throttling interrupts on the same pin used to
	  trigger throttling. The GPIO should be configured as an output by
	  default. throttle_ap_config_prochot will configure the GPIO as
	  an interrupt. Chipset specific functions are responsible for
	  handling any subsequent changes.

config PLATFORM_EC_THROTTLE_AP_NO_FAN
	bool "No automatic fan control for AP throttling"
	help
	  Disable automatic fan control when an AP throttling interrupt occurs.

config PLATFORM_EC_THROTTLE_AP_ON_BAT_DISCHG_CURRENT
	bool "Throttle AP based on battery discharge current"
	default n
	help
	  Throttle the CPU when battery discharge current is too high. When
	  this feature is enabled, the threshold value must be set in
	  PLATFORM_EC_THROTTLE_AP_ON_BAT_DISCHG_CURRENT_LIMIT.

config PLATFORM_EC_THROTTLE_AP_ON_BAT_LOW_VOLTAGE
	bool "Throttle AP based on battery voltage"
	default n
	help
	  Throttle the CPU when battery voltage drops below a defined threshold
	  where the board still boots but some components don't function
	  perfectly. When this feature is enabled, the threshold value must be
	  set in PLATFORM_EC_THROTTLE_AP_ON_BAT_LOW_VOLTAGE_THRESH.

config PLATFORM_EC_GPU_NVIDIA
	bool "Nvidia GPU supports throttling"
	default n
	help
	  Enable GPU throttling. When the GPU is throttled, a software (D-Notify)
	  and a hardware throttle (GPIO_NVIDIA_GPU_ACOFF_ODL) are enabled. A
	  hardware throttle will be automatically disabled after a fixed period
	  of time but a software throttle may remain and keep changing as the
	  situation changes.

endif # PLATFORM_EC_THROTTLE_AP
```

## zephyr/boards/google/it8xxx2/Kconfig.defconfig
```kconfig
# Copyright 2021 The ChromiumOS Authors
# Use of this source code is governed by a BSD-style license that can be
# found in the LICENSE file.

if BOARD_IT8XXX2

configdefault CROS_EC_HOOK_TICK_INTERVAL
	default 500000

configdefault SYS_CLOCK_HW_CYCLES_PER_SEC
	default 32768

configdefault SYS_CLOCK_TICKS_PER_SEC
	default 32768

if ADC
configdefault PLATFORM_EC_ADC_RESOLUTION
	default 10
endif # ADC

if CONSOLE
configdefault UART_CONSOLE
	default y
endif # CONSOLE

if FLASH
configdefault PLATFORM_EC_CONSOLE_CMD_FLASH
	default y
endif # FLASH

if SERIAL
configdefault UART_INTERRUPT_DRIVEN
	default y
endif # SERIAL

if WATCHDOG
configdefault PLATFORM_EC_WATCHDOG_PERIOD_MS
	default 2500
configdefault WDT_ITE_WARNING_LEADING_TIME_MS
	default 500
configdefault WDT_ITE_REDUCE_WARNING_LEADING_TIME
	default y
endif # WATCHDOG

if PLATFORM_EC_VBOOT_HASH
configdefault SOC_IT8XXX2_SHA256_HW_ACCELERATE
	default y
choice PLATFORM_EC_SHA256_MODE
	default PLATFORM_EC_SHA256_HW_ACCELERATE if SOC_IT8XXX2_SHA256_HW_ACCELERATE
endchoice
endif # PLATFORM_EC_VBOOT_HASH

if SRAM_SIZE >= 128
configdefault LTO
	default n

configdefault SOC_IT8XXX2_SERIAL_IN_RAM
	default y if !LTO

configdefault SOC_IT8XXX2_KERNEL_IN_RAM
	default y if !LTO

configdefault SOC_IT8XXX2_ZEPHYR_IN_RAM
	default y if !LTO
endif # SRAM_SIZE

if RISCV_PMP
configdefault PMP_DATA_EXECUTION_PREVENTION
	default n

configdefault PMP_NO_LOCK_GLOBAL
	default y if CROS_EC_RO
endif # RISCV_PMP

configdefault SOC_IT8XXX2_UART_TX_STRATPPING_PIN
	default y if SOC_IT8XXX2_REG_SET_V2 && CROS_EC_RO

endif # BOARD_IT8XXX2
```

## zephyr/boards/google/mec172x/Kconfig.defconfig
```kconfig
# Copyright 2022 The ChromiumOS Authors
# Use of this source code is governed by a BSD-style license that can be
# found in the LICENSE file.

if BOARD_MEC172X

# Zephyr internal stack sizes

configdefault IDLE_STACK_SIZE
	default 400

configdefault SYSTEM_WORKQUEUE_STACK_SIZE
	default 1024

# Chromium EC stack sizes

configdefault TASK_CHARGER_STACK_SIZE
	default 1056

configdefault TASK_KEYSCAN_STACK_SIZE
	default 1024

configdefault TASK_PD_STACK_SIZE
	default 1184

configdefault TASK_PD_INT_STACK_SIZE
	default 1024

configdefault TASK_USB_CHG_STACK_SIZE
	default 1024

endif # BOARD_MEC172X
```

## zephyr/boards/google/realtek/Kconfig.defconfig
```kconfig
# Copyright 2025 The ChromiumOS Authors
# Use of this source code is governed by a BSD-style license that can be
# found in the LICENSE file.

configdefault UART_NS16550_WA_ISR_REENABLE_INTERRUPT
	default y

if REALTEK_RTS5912_RTMR

configdefault PM
	default y

configdefault SYS_CLOCK_HW_CYCLES_PER_SEC
	default 32768

configdefault SYS_CLOCK_TICKS_PER_SEC
	default 32768

endif # REALTEK_RTS5912_RTMR

if WATCHDOG

configdefault PLATFORM_EC_WATCHDOG_HELPER
	default y

configdefault WDT_COUNTER
	default y

endif # WATCHDOG

if ADC

configdefault PLATFORM_EC_ADC_RESOLUTION
	default 12

endif # ADC

configdefault KERNEL_ENTRY
	default "__trampoline" if REALTEK_RTS5912_TRAMPOLINE
```

## zephyr/drivers/ap_throttle/Kconfig
```kconfig
# Copyright 2026 The ChromiumOS Authors
# Use of this source code is governed by a BSD-style license that can be
# found in the LICENSE file.

config AP_THROTTLE
	bool "GPIO-based AP throttling driver"
	default y
	depends on DT_HAS_CROS_EC_AP_THROTTLE_ENABLED
	select PLATFORM_EC_THROTTLE_AP
	help
	  Enable the common GPIO-based AP throttling driver. This driver controls
	  the AP throttle / PROCHOT GPIO via devicetree, implements
	  chipset_throttle_cpu(), handles AC-only boot power limiting.
```

## zephyr/drivers/fingerprint/Kconfig.egis
```kconfig
# Copyright 2025 The ChromiumOS Authors
# Use of this source code is governed by a BSD-style license that can be
# found in the LICENSE file.


menuconfig FINGERPRINT_SENSOR_EGIS630
	bool "Fingerprint driver for EGIS630"
	default y
	depends on DT_HAS_EGIS_EGIS630_ENABLED
	help
	  Driver for EGIS630 fingerprint sensor. It requires EGIS private library
	  to implement cros_fingerprint API. If the library is not available it
	  only supports checking sensor hardware ID.

if FINGERPRINT_SENSOR_EGIS630

config FINGERPRINT_SENSOR_EGIS630_HEAP_SIZE
	int "Size of heap for EGIS630 driver"
	default 108544
	help
	  Size of heap to be used by EGIS private library. The heap must have
	  enough size to keep finger templates during matching.
	  106KB is enough to match 3 templates at once.

config FINGERPRINT_SENSOR_EGIS630_PAL
	bool "Platform Abstraction Layer for EGIS private library"
	default y if HAVE_EGIS630_PRIVATE_DRIVER
	help
	  If enabled, Platform Abstraction Layer for EGIS private library will be
	  compiled. The PAL is used to interact with the sensor (SPI, GPIO) and
	  the system (heap allocations, printing messages, time functions).

# Enabled in private driver Kconfig
config HAVE_EGIS630_PRIVATE_DRIVER
	bool
	default n
	help
	  If enabled, it indicates that the private driver is present.

endif # FINGERPRINT_SENSOR_EGIS630

menuconfig FINGERPRINT_SENSOR_EGIS660
	bool "Fingerprint driver for EGIS660"
	default y
	depends on DT_HAS_EGIS_EGIS660_ENABLED
	help
	  Driver for EGIS660 fingerprint sensor. It requires EGIS private library
	  to implement cros_fingerprint API. If the library is not available it
	  only supports checking sensor hardware ID.

if FINGERPRINT_SENSOR_EGIS660

choice FINGERPRINT_SENSOR_EGIS660_COVER
	prompt "EGIS660 sensor cover type"
	default FINGERPRINT_SENSOR_EGIS660_COVER_SPRAY_COATING if $(dt_compat_all_has_prop,$(DT_COMPAT_EGIS_EGIS660),cover-type,spray-coating)
	default FINGERPRINT_SENSOR_EGIS660_COVER_GLASS if $(dt_compat_all_has_prop,$(DT_COMPAT_EGIS_EGIS660),cover-type,glass)
	default FINGERPRINT_SENSOR_EGIS660_COVER_GLASS if $(dt_compat_any_not_has_prop,$(DT_COMPAT_EGIS_EGIS660),cover-type)
	help
	  Select the cover type of the EGIS660 sensor to use the appropriate
	  private library. This should match the cover-type property in the
	  device tree.

config FINGERPRINT_SENSOR_EGIS660_COVER_GLASS
	bool "Glass cover"
	help
	  Select this option for EGIS660 sensor with glass cover.

config FINGERPRINT_SENSOR_EGIS660_COVER_SPRAY_COATING
	bool "Spray coating"
	help
	  Select this option for EGIS660 sensor with spray coating cover.

endchoice

config FINGERPRINT_SENSOR_EGIS660_HEAP_SIZE
	int "Size of heap for EGIS660 driver"
	default 153600
	help
	  Size of heap to be used by EGIS private library. The heap must have
	  enough size to keep finger templates during matching.
	  150KB is enough to match 3 templates at once.

config FINGERPRINT_SENSOR_EGIS660_PAL
	bool "Platform Abstraction Layer for EGIS private library"
	default y if HAVE_EGIS660_PRIVATE_DRIVER
	help
	  If enabled, Platform Abstraction Layer for EGIS private library will be
	  compiled. The PAL is used to interact with the sensor (SPI, GPIO) and
	  the system (heap allocations, printing messages, time functions).

config FINGERPRINT_SENSOR_EGIS660_APNS
	bool "EGIS660 APNS storage"
	default y
	depends on $(dt_nodelabel_enabled,egis660_apns_data)
	help
	  If enabled, the APNS(Adaptive Pixel Noise Suppression) data generated
	  during the enroll and match can be stored on APNS storage.

# Enabled in private driver Kconfig
config HAVE_EGIS660_PRIVATE_DRIVER
	bool
	default n
	help
	  If enabled, it indicates that the EGIS660 private driver is present.

endif # FINGERPRINT_SENSOR_EGIS660
```

## zephyr/drivers/pwrmon/Kconfig
```kconfig
# Copyright 2026 The ChromiumOS Authors
# Use of this source code is governed by a BSD-style license that can be
# found in the LICENSE file.

config PWRMON
	bool "Power monitoring"
	default y
	depends on DT_HAS_CROS_PWRMON_ENABLED
	help
	  This option enables power monitoring which serves interface
	  between AP and power monitors.

config PWRMON_THREAD_STACK_SIZE
	int "Pwrmon thread stack size (in bytes)"
	default 1024
	help
	  Stack size of thread created for the pwrmon.

config PWRMON_THREAD_PRIORITY
	int "Pwrmon thread priority"
	default 10
	help
	  Set thread priority of the pwrmon.

config PWRMON_MSGQ_SIZE
	int "Pwrmon message queue size"
	default 16
	help
	  Set message queue size for the pwrmon.

choice PWRMON_POWER_MONITOR
	prompt "Select the power monitor shim"
	default PWRMON_POWER_MONITOR_PAC194X if DT_HAS_MICROCHIP_PAC194X_ENABLED
	default PWRMON_POWER_MONITOR_COMMON
	depends on PWRMON

config PWRMON_POWER_MONITOR_COMMON
	bool "Common zephyr sensor channels and attributes"
	help
	  This option enables common sensor channels for power monitors.

config PWRMON_POWER_MONITOR_PAC194X
	bool "PAC194x power monitor shim"
	help
	  This option enables shim for Microchip PAC194x/PAC195x family
	  of power monitors.

endchoice
```

## zephyr/dts/bindings/battery/atl,as3gxxg3ka.yaml
```yaml
# Copyright 2026 The ChromiumOS Authors
# Use of this source code is governed by a BSD-style license that can be
# found in the LICENSE file.

description: "ATL AS3GXXG3KA"
compatible: "atl,as3gxxg3ka"

include: battery-smart.yaml

properties:
  enum-name:
    type: string
    default: "atl,as3gxxg3ka"

  # Fuel gauge
  manuf_name:
    default: "AS3GXXG3KA"
  device_name:
    default: "G520746"
  ship_mode_reg_addr:
    default: 0x00
  ship_mode_reg_data:
    default: [0x0010, 0x0010]
  flags:
    default: 0x04
  fet_reg_addr:
    default: 0x0
  fet_reg_mask:
    default: 0x0006
  fet_disconnect_val:
    default: 0x0
  fet_cfet_mask:
    default: 0x0004
  fet_cfet_off_val:
    default: 0x0

  # Battery info
  voltage_max:
    default: 9000
  voltage_normal:
    default: 7800
  voltage_min:
    default: 6000
  precharge_current:
    default: 256
  start_charging_min_c:
    default: 1
  start_charging_max_c:
    default: 45
  charging_min_c:
    default: 1
  charging_max_c:
    default: 60
  discharging_min_c:
    default: -20
  discharging_max_c:
    default: 60
```

## zephyr/dts/bindings/battery/smp,a540734.yaml
```yaml
description: "SMP battery"
compatible: "smp,a540734"

include: battery-smart.yaml

properties:
  enum-name:
    type: string
    default: "smp,a540734"

  # Fuel gauge
  manuf_name:
    default: "AS3GXXD3KC"
  device_name:
    default: "A540734"
  ship_mode_reg_addr:
    default: 0x00
  ship_mode_reg_data:
    default: [0x0010, 0x0010]
  fet_reg_addr:
    default: 0x99
  fet_reg_mask:
    default: 0x0008
  fet_disconnect_val:
    default: 0x0008
  fet_cfet_mask:
    default: 0x0004
  fet_cfet_off_val:
    default: 0x0004

  # Battery info
  voltage_max:
    default: 18000
  voltage_normal:
    default: 16068
  voltage_min:
    default: 12000
  precharge_current:
    default: 256
  start_charging_min_c:
    default: 0
  start_charging_max_c:
    default: 45
  charging_min_c:
    default: 0
  charging_max_c:
    default: 60
  discharging_min_c:
    default: -20
  discharging_max_c:
    default: 60
```
