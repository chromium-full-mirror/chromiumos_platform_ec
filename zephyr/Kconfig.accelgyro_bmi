## zephyr/Kconfig.accelgyro_bmi
```kconfig
# Copyright 2021 The ChromiumOS Authors
# Use of this source code is governed by a BSD-style license that can be
# found in the LICENSE file.


if PLATFORM_EC_ACCELGYRO_BMI
menu "BMI Sensor Common"

choice PLATFORM_EC_ACCELGYRO_BMI_COMM
	prompt "Accelgyro BMI's communication mode"
	help
	  When using the BMI drivers, there's the option to communicate with the
	  chip via several methods. This choice helps improve code size by only
	  compiling the needed communication channels.

config PLATFORM_EC_ACCELGYRO_BMI_COMM_SPI
	bool "Use SPI communication"
	help
	  The BMI chip is using SPI communication. This config value is used to
	  save on code size as only the SPI communication code will be included
	  for the BMI chip.

config PLATFORM_EC_ACCELGYRO_BMI_COMM_I2C
	bool "Use I2C communication"
	help
	  The BMI chip is using I2C communication. This config value is used to
	  save on code size as only the I2C communication code will be included
	  for the BMI chip.

endchoice

config PLATFORM_EC_BMI260_I2C_XFER_LARGE_PAYLOAD_SUPPORT
	bool "Enable BMI260_I2C_XFER"
	depends on !PLATFORM_EC_ACCELGYRO_BMI_COMM_SPI
	help
	  To reduce BMI260 initialization overhead, this config leverages the
	  DMA function. We switch to using `i2cxfer` during the initialization
	  process after enabling I2C_XFER_LARGE_PAYLOAD_SUPPORT

endmenu # BMI Sensor
endif # PLATFORM_EC_ACCELGYRO_BMI
```

## zephyr/Kconfig.body_detection
```kconfig
# Copyright 2022 The ChromiumOS Authors
# Use of this source code is governed by a BSD-style license that can be
# found in the LICENSE file.

menuconfig PLATFORM_EC_BODY_DETECTION
	bool "Sensor body detection"
	help
	  Enable the body detection function.

	  The Power Reduction Algorithm is based on the Motion Detector
	  output of In Motion (on body) state or Stationary (off body) state.
	  The input of the Motion Detector is the X and Y axis signal
	  from an accelerometer.

if PLATFORM_EC_BODY_DETECTION

choice BODY_DETECTION_ALGORITHM
	prompt "Select on-body detection algorithm"
	default BODY_DETECTION_ALGORITHM_V1

config BODY_DETECTION_ALGORITHM_V1
	bool "Legacy version of the on-body detection"
	help
	  Leverages a basic calculation of variance to detect spikes in the
	  accelerometer. This algorithm is sensitive to the sample rate as it
	  doesn't include any decimation. Sample rates should be at 50Hz for this
	  algorithm to work well.

config BODY_DETECTION_ALGORITHM_V2
	bool "New on-body detection algorithm"
	select FPU
	help
	  Update the on-body detection algorithm to leverage smoothing and
	  decimation of the sample rate when it doesn't match the algorithm's
	  desired rate.

endchoice

config PLATFORM_EC_BODY_DETECTION_DYNAMIC_INDEX
	bool "Decide at runtime which sensor will be used for on-body-detection"
	help
	  By default (when disabled) use the alias on-body-sensor to select the
	  body detection sensor. When enabled, the board should notify the
	  sensor stack which sensor to use by calling
	  motion_sense_set_on_body_sensor_index().

config PLATFORM_EC_BODY_DETECTION_MAX_WINDOW_SIZE
	int "Maximal sensor data rate"
	default 250
	help
	  Sets the maximum sensor data rate, in Hz. Note that larger data rate
	  values consume more memory and computing resource.

config PLATFORM_EC_BODY_DETECTION_VAR_THRESHOLD
	int "The threshold of acceleration variance for confidence calculation"
	default 4000 if BODY_DETECTION_ALGORITHM_V2
	default 550
	help
	  This thresholding is under migration, the unit is (mm/s^2)^2 for the
	  legacy on-body detection, while the unit is uG for the V2.

	  The motion confidence is calculated if the variance estimator is
	  within variance_threshold +/- confidence_delta. Otherwise, if
	  variance estimator is too high/low, confidence will be 100%/0%

config PLATFORM_EC_BODY_DETECTION_CONFIDENCE_DELTA
	int "The delta of acceleration variance for confidence calculation"
	default 3000 if BODY_DETECTION_ALGORITHM_V2
	default 525
	help
	  This thresholding is under migration, the unit is (mm/s^2)^2 for the
	  legacy on-body detection, while the unit is uG for the V2.

	  The value of hysteresis applied to threshold-based detection.
	  Once the variance estimator exceeded variance_threshold +
	  confidence_delta and on-body state was activated it needs to
	  fall below variance_threshold - confidence_delta to return to
	  off-body state.

config PLATFORM_EC_BODY_DETECTION_VAR_NOISE_FACTOR
	int "How much noise affects the threshold of variance"
	default 120
	help
	  The unit is percentage

	  This is used for mitigate the effect of the noise from the sensor.
	  If set to 100%, the average noise is canceled out. This is set to
	  120% by default because the noise might get larger than average
	  sometimes.

config PLATFORM_EC_BODY_DETECTION_ON_BODY_CON
	int "The confidence limit of on_body"
	default 90 if BODY_DETECTION_ALGORITHM_V2
	default 50
	help
	  The unit is percentage

	  Higher the value, more diffcult to enter the on-body from off-body

config PLATFORM_EC_BODY_DETECTION_OFF_BODY_CON
	int "The confidence limit of off body"
	default 10
	help
	  The unit is percentage

	  Lower the value, more diffcult to enter the off-body from on-body.
	  Should be set less than the PLATFORM_EC_BODY_DETECTION_ON_BODY_CON

config PLATFORM_EC_BODY_DETECTION_STATIONARY_DURATION
	int "The threshold duration to change to off_body"
	default 15
	help
	  The unit is seconds

	  How long should we stay in on-body state before entering to off-body
	  state when the motion confidence is less than
	  PLATFORM_EC_BODY_DETECTION_OFF_BODY_CON

config PLATFORM_EC_BODY_DETECTION_NOTIFY_MODE_CHANGE
	bool "Notify host with a specific host event when body status is changed"
	default n
	help
	  Notify the host via SCI events EC_HOST_EVENT_BODY_DETECT_CHANGE when body
	  status is changed, in addition to adding an event in the motion sensor
	  FIFO queue.

config PLATFORM_EC_BODY_DETECTION_NOTIFY_MKBP
	bool "Notify host with MKBP event when the body on/off"
	default n
	help
	  Notify the host via EC_MKBP_FRONT_PROXIMITY
	  when the body status changed.

config PLATFORM_EC_BODY_DETECTION_ALWAYS_ENABLE_IN_S0
	bool "Always enable body detection function in S0"
	default n
	help
	  Always enable the body detection function in S0
	  w/o the host command

endif # PLATFORM_EC_BODY_DETECTION
```

## zephyr/Kconfig.button
```kconfig
# Copyright 2026 The ChromiumOS Authors
# Use of this source code is governed by a BSD-style license that can be
# found in the LICENSE file.

config PLATFORM_EC_BUTTON
	bool "Enable button support"
	help
	  Enable Chrome EC button library support. It is required for keyboard
	  and dedicated recovery button support.

config PLATFORM_EC_BUTTON_TRIGGERED_RECOVERY
	bool "Support entering recovery mode using buttons"
	select PLATFORM_EC_BUTTON
	help
	  Support for entering recovery mode using the volume buttons or a
	  dedicated recovery button. Note that these are *buttons* and not keys
	  in the keyboard matrix.

config PLATFORM_EC_VOLUME_BUTTONS
	bool "Board has volume-up and volume-down buttons"
	select PLATFORM_EC_BUTTON
	help
	  Enable this if the board has physical buttons for the volume controls.
	  These are buttons controlled by GPIOs and are not part of the keyboard
	  matrix.

	  Your board must define GPIO_VOLUME_UP_L and GPIO_VOLUME_DOWN_L as
	  GPIOs names or as aliases in the GPIO devicetree configuration.

config PLATFORM_EC_DEDICATED_RECOVERY_BUTTON
	bool "Enable dedicated recovery button"
	select PLATFORM_EC_BUTTON_TRIGGERED_RECOVERY
	help
	  Indicates there is a dedicated recovery button.  Note, that if there
	  are volume buttons, a dedicated recovery button is not needed.
	  This is intended because if a board has volume buttons, they can do
	  everything a dedicated recovery button can do.

config PLATFORM_EC_DEDICATED_RECOVERY_BUTTON_ACTIVE_HIGH
	bool "Recovery button is active high"
	depends on PLATFORM_EC_DEDICATED_RECOVERY_BUTTON
	help
	  Configure recovery button to use high state as active.

config PLATFORM_EC_DEDICATED_RECOVERY_BUTTON_2
	bool "Enable second dedicated recovery button"
	select PLATFORM_EC_BUTTON_TRIGGERED_RECOVERY
	help
	  Enable use of second dedicated recovery button.
	  For various reasons, on some platforms there may be multiple
	  recovery inputs. See b/149967026.

config PLATFORM_EC_DEDICATED_RECOVERY_BUTTON_2_ACTIVE_HIGH
	bool "Second recovery button is active high"
	depends on PLATFORM_EC_DEDICATED_RECOVERY_BUTTON_2
	help
	  Configure second recovery button to use high state as active.

config PLATFORM_EC_BUTTON_DEBOUNCE
	int "button debounce in us"
	default 30000
	help
	  Configure the button debounce time in us per project requirement.

config PLATFORM_EC_BUTTONS_RUNTIME_CONFIG
	bool "Enable buttons runtime configuration"
	help
	  This command allow the runtime configuration of the buttons[]
	  array.

config PLATFORM_EC_CMD_BUTTON
	bool "Console command: button"
	help
	  This command simulates button press. The buttons are like volume-up,
	  volume-down, and recovery buttons.
```

## zephyr/Kconfig.fingerprint
```kconfig
# Copyright 2024 The ChromiumOS Authors
# Use of this source code is governed by a BSD-style license that can be
# found in the LICENSE file.

config PLATFORM_EC_FINGERPRINT
	bool "Support for fingerprint authentication subsystem"
	depends on BORINGSSL_CRYPTO
	depends on FULL_LIBCPP_SUPPORTED
	select HAS_TASK_FPSENSOR
	help
	  This option enables fingerprint authentication subsystem which
	  is a complete Match On Chip solution. Operations (e.g. enroll,
	  match) are exposed to AP using Host Command interface.

if PLATFORM_EC_FINGERPRINT

config FINGERPRINT_SHELL
	bool "Enable fingerprint debugging console commands"
	help
	  This option adds fingerprint console commands that can be used to
	  verify fingerpint functionality.

config PLATFORM_EC_FINGERPRINT_VENDOR_COMMAND
	bool "Enable fingerprint vendor defined host command"
	help
	  Enables support for FP vendor defined host command. The command can
	  be handled only if the system is not locked.

	  If enabled, the fp_vendor_command function has to be defined.

choice PLATFORM_EC_FINGERPRINT_AUTH_METHOD
	prompt "Fingerprint authentication method"
	default PLATFORM_EC_FINGERPRINT_AUTH_METHOD_ASCP if ASCP
	default PLATFORM_EC_FINGERPRINT_AUTH_METHOD_HANDSHAKE
	help
	  This option selects the authentication method for the fingerprint.

config PLATFORM_EC_FINGERPRINT_AUTH_METHOD_HANDSHAKE
	bool "Handshake"
	help
	  The fingerprint is authenticated using handshake.

config PLATFORM_EC_FINGERPRINT_AUTH_METHOD_ASCP
	bool "ASCP"
	help
	  The fingerprint is authenticated using ASCP.

endchoice

endif # PLATFORM_EC_FINGERPRINT

DT_ALIAS_PWM_FP_LED := pwm-fp-led

config PLATFORM_EC_FP_LED
	bool "Enable fingerprint sensor led"
	help
	  Enables controlling of fingerprint led.
	  If enabled, the pwm-fp-led alias has to be defined in DT.
	default y
	depends on $(dt_alias_enabled,$(DT_ALIAS_PWM_FP_LED))

if PLATFORM_EC_FP_LED

config PLATFORM_EC_FP_LED_BRIGHTNESS_ENROLL
	int "Fingerprint LED perceived brightness during enroll session"
	default 70
	range 0 100
	help
	  The perceived brightness of the fingerprint LED during enrollment,
	  in percentage.

config PLATFORM_EC_FP_LED_BRIGHTNESS_MATCH
	int "Fingerprint LED perceived brightness during match session"
	default 70
	range 0 100
	help
	  The perceived brightness of the fingerprint LED during matching,
	  in percentage.

config PLATFORM_EC_FP_LED_BRIGHTNESS_MATCH_OK
	int "Fingerprint LED perceived brightness after successful match"
	default 100
	range 0 100
	help
	  The perceived brightness of the fingerprint LED after a successful
	  match, in percentage.

config PLATFORM_EC_FP_LED_BRIGHTNESS_MATCH_NOK
	int "Fingerprint LED perceived brightness after failed match"
	default 40
	range 0 100
	help
	  The perceived brightness of the fingerprint LED after a failed match,
	  in percentage.

config PLATFORM_EC_FP_LED_DURATION_MATCH_MS
	int "Fingerprint LED duration during match session (ms)"
	default 10000
	help
	  The duration the fingerprint LED stays on during a match session, in
	  milliseconds.

config PLATFORM_EC_FP_LED_DURATION_MATCH_OK_MS
	int "Fingerprint LED duration after successful match (ms)"
	default 2000
	help
	  The duration the fingerprint LED stays on after a successful match, in
	  milliseconds.

config PLATFORM_EC_FP_LED_DURATION_MATCH_NOK_MS
	int "Fingerprint LED duration after failed match (ms)"
	default 1000
	help
	  The duration the fingerprint LED stays on after a failed match, in
	  milliseconds.

endif # PLATFORM_EC_FP_LED

DT_NODELABEL_FP_SENSOR_VENDOR_DATA := fingerprint_sensor_vendor_data

config PLATFORM_EC_FP_VENDOR_DATA
	bool "Enable fingerprint sensor vendor data storage"
	# Only needed by the RW image, where the fingerprint subsystem lives.
	# Tests without PLATFORM_EC_FINGERPRINT enable it explicitly.
	default y if PLATFORM_EC_FINGERPRINT
	depends on $(dt_nodelabel_enabled,$(DT_NODELABEL_FP_SENSOR_VENDOR_DATA))
	# Zephyr flash API for reads, cros_flash for erase/write (it also
	# provides CONFIG_FLASH_ERASE_SIZE).
	depends on FLASH && PLATFORM_EC_FLASH_CROS
	# The cache is implemented in C++20 (std::bitset, std::ranges).
	depends on CPP && STD_CPP20
	depends on FULL_LIBCPP_SUPPORTED
	help
	  Enables a write-back RAM cache for vendor specific fingerprint sensor
	  data (e.g. calibration) kept in a dedicated flash partition. The
	  partition is loaded into RAM by the fingerprint task at start-up and
	  modified sectors are written back only when fp_vendor_data_sync() is
	  called.

	  The flash partition must be labelled fingerprint_sensor_vendor_data
	  in the devicetree and its size must be a multiple of the flash erase
	  size.

config PLATFORM_EC_FP_VENDOR_DATA_ALIGNMENT
	int "Vendor data buffer alignment"
	default DCACHE_LINE_SIZE if DCACHE_LINE_SIZE > 0
	default 4
	depends on PLATFORM_EC_FP_VENDOR_DATA
	help
	  Alignment, in bytes, of the RAM buffer that mirrors the vendor data
	  partition. Flash drivers may require the source buffer of a write
	  to be aligned, e.g. to a word or, when the transfer is done by DMA
	  with cache maintenance, to a data cache line. Must be a power of
	  two.
```

## zephyr/Kconfig.power_button
```kconfig
# Copyright 2026 The ChromiumOS Authors
# Use of this source code is governed by a BSD-style license that can be
# found in the LICENSE file.

config PLATFORM_EC_HOSTCMD_POWER_BUTTON_PRESS
	bool "Enable power button press host command"
	default n
	depends on HAS_HOSTCMD
	help
	  Command used to simulate up to 2 power button presses from the host
	  with configurable delay and duration.

config PLATFORM_EC_POWER_BUTTON_KEYBOARD
	bool "Power button is on the keyboard matrix"
	depends on DT_HAS_CROS_EC_POWER_BUTTON_KEYBOARD_ENABLED
	depends on PLATFORM_EC_TABLET_MODE
	help
	  Enable this option if the power button is located on the keyboard matrix.
	  This enables logic to suppress power button events in S0 tablet mode
	  to prevent accidental activation.

	  Requires a "cros-ec,power-button-keyboard" devicetree node with the
	  "suppress-enable-pin" property (e.g. mapped to the eDP backlight
	  enable signal) to gate S0 tablet mode suppression on that GPIO being
	  asserted, allowing the power button to wake the display when the
	  screen is off in S0.
```
