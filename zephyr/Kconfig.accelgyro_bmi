## zephyr/dts/bindings/battery/smp,sb1fb00014.yaml
```yaml
# Copyright 2026 The ChromiumOS Authors
# Use of this source code is governed by a BSD-style license that can be
# found in the LICENSE file.

description: "SIMPLO SB1FB00014"
compatible: "smp,sb1fb00014"

include: battery-smart.yaml

properties:
  enum-name:
    type: string
    default: "smp,sb1fb00014"

  # Fuel gauge
  manuf_name:
    default: "SIMPLO"
  device_name:
    default: "SB1FB00014"
  ship_mode_reg_addr:
    default: 0x3A
  ship_mode_reg_data:
    default: [0xC574, 0xC574]
  flags:
    default: 0
  fet_reg_addr:
    default: 0x00
  fet_reg_mask:
    default: 0x4000
  fet_disconnect_val:
    default: 0x0000
  fet_cfet_mask:
    default: 0x8000
  fet_cfet_off_val:
    default: 0x0000

  # Battery info
  voltage_max:
    default: 12900
  voltage_normal:
    default: 11490
  voltage_min:
    default: 9000
  precharge_current:
    default: 204
  start_charging_min_c:
    default: 0
  start_charging_max_c:
    default: 45
  charging_min_c:
    default: 0
  charging_max_c:
    default: 60
  discharging_min_c:
    default: -20
  discharging_max_c:
    default: 60
```

## zephyr/dts/bindings/battery/swd,swd.yaml
```yaml
# Copyright 2026 The ChromiumOS Authors
# Use of this source code is governed by a BSD-style license that can be
# found in the LICENSE file.

description: "SWD SWD"
compatible: "swd,swd"

include: battery-smart.yaml

properties:
  enum-name:
    type: string
    default: "swd,swd"

  # Fuel gauge
  manuf_name:
    default: "SWD"
  device_name:
    default: "G82300957"
  ship_mode_reg_addr:
    default: 0x00
  ship_mode_reg_data:
    default: [0x0010, 0x0010]
  flags:
    default: 0x0004
  fet_reg_addr:
    default: 0x54
  fet_reg_mask:
    default: 0x0006
  fet_disconnect_val:
    default: 0x0000
  fet_cfet_mask:
    default: 0x0004
  fet_cfet_off_val:
    default: 0x0000

  # Battery info
  voltage_max:
    default: 9060
  voltage_normal:
    default: 7800
  voltage_min:
    default: 6000
  precharge_current:
    default: 256
  start_charging_min_c:
    default: 0
  start_charging_max_c:
    default: 46
  charging_min_c:
    default: 0
  charging_max_c:
    default: 49
  discharging_min_c:
    default: -20
  discharging_max_c:
    default: 60
```
