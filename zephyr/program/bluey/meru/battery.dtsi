/* Copyright 2026 The ChromiumOS Authors
 * Use of this source code is governed by a BSD-style license that can be
 * found in the LICENSE file.
 */

/ {
	batteries {
		default_battery:atl_as3gxxg3ka {
			compatible = "atl,as3gxxg3ka", "battery-smart";
			has_manuf_info;
		};
	};
};
