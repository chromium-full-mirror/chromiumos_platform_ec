/* Copyright 2026 The ChromiumOS Authors
 * Use of this source code is governed by a BSD-style license that can be
 * found in the LICENSE file.
 */

/ {
	batteries {
		default_battery: smp_l26d4pk3 {
			compatible = "sunwoda,l26d4pk3", "battery-smart";
			has_manuf_info;
		};
	};
};
