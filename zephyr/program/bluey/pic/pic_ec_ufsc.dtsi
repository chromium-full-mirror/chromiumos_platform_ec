/* Copyright 2026 The ChromiumOS Authors
 * Use of this source code is governed by a BSD-style license that can be
 * found in the LICENSE file.
 */

#include <cros/cbi_ufsc_std_schema.dtsi>
#include <cros/cbi_ufsc_oem_schema.dtsi>

/*
 * pic board-specific UFSC value definitions.
 *
 * Keyboard physical layout uses the standard KEYBOARD_LAYOUT field
 * (UFSC_KEYBOARD_LAYOUT, 3 bits). Factory programs the field as:
 *   0 = US (default)
 *   1 = UK
 *   2 = JP
 */

&ufsc_keyboard_layout {
	ufsc_kb_layout_us: kb-layout-us {
		compatible = "cros-ec,cbi-ufsc-value";
		status = "okay";
		value = <0>;
	};
	ufsc_kb_layout_uk: kb-layout-uk {
		compatible = "cros-ec,cbi-ufsc-value";
		status = "okay";
		value = <1>;
	};
	ufsc_kb_layout_jp: kb-layout-jp {
		compatible = "cros-ec,cbi-ufsc-value";
		status = "okay";
		value = <2>;
	};
};
