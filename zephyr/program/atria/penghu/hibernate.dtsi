/* Copyright 2026 The ChromiumOS Authors
 * Use of this source code is governed by a BSD-style license that can be
 * found in the LICENSE file.
 */

/* Platform based hibernate support triggered using the EN_SLP_Z signal */

/{
	hibernate_z5: hibernate-z5 {
		compatible = "cros-ec,hibernate-z5";
		en-slp-z-gpios = <&gpiod 4 GPIO_ACTIVE_HIGH>;
	};
};
