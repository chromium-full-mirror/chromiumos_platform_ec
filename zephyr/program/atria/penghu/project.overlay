/* Copyright 2026 The ChromiumOS Authors
 * Use of this source code is governed by a BSD-style license that can be
 * found in the LICENSE file.
 */

/* penghu program common DTS includes */
#include <cros/integrated_fwid.dtsi>

/* penghu project DTS includes */
#include "binman.dtsi"
#include "gpios.dtsi"
#include "interrupts.dtsi"
#include "i2c.dtsi"

/* AP interface */
&espi0 {
	status = "okay";
};

&sha0 {
	status = "okay";
};
