/* Copyright 2026 The ChromiumOS Authors
 * Use of this source code is governed by a BSD-style license that can be
 * found in the LICENSE file.
 */

#include "lb_colors.h"

/ {
	led_pins2:lightbar {
		status = "okay";
		compatible = "cros-ec,led-lightbar";
		led-segments = <0x1 0x2 0x4 0x8>;
		lightbar0 {
			led-id = "EC_LED_ID_LIGHTBAR_LED";
			strip = <&spi0_dev0>;
		};
	};
};
