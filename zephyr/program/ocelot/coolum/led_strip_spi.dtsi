/* Copyright 2026 The ChromiumOS Authors
 * Use of this source code is governed by a BSD-style license that can be
 * found in the LICENSE file.
 */

#include <zephyr/dt-bindings/gpio/gpio.h>
#include <zephyr/dt-bindings/led/led.h>

&spi0 {
	status = "okay";
	pinctrl-0 = <&spi_ssce0_default &spi_smosi_default>;
	pinctrl-names = "default";

	spi0_dev0: spi0_dev@0 {
		reg = <0>;
		compatible = "worldsemi,ws2812-spi";
		color-mapping = <LED_COLOR_ID_RED
				 LED_COLOR_ID_GREEN
				 LED_COLOR_ID_BLUE>;
		chain-length = <4>;
		reset-delay = <205>;
		spi-max-frequency = <6000000>;
		bits-per-symbol = <8>;
		spi-one-frame = <0xF8>;
		spi-zero-frame = <0xC0>;
	};
};

&led_pins2 {
	default-brightness-percent = <60>;
	min-brightness-percent = <2>;
	max-power-constrained-white-rgb = <0x323221>;
	enable-gpios = <&gpiog 3 0>;
	ramp-up-delay-ms = <3>;
};
