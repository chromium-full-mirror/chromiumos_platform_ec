/* Copyright 2026 The ChromiumOS Authors
 * Use of this source code is governed by a BSD-style license that can be
 * found in the LICENSE file.
 */

/* KB_LED_PWM */
&pwm6 {
	status = "okay";
	pinctrl-0 = <&pwm6_gpio029>;
	pinctrl-names = "default";
};

/* FAN1_PWM */
&pwm2 {
	status = "okay";
	pinctrl-0 = <&pwm2_gpio025>;
	pinctrl-names = "default";
};
&pwm3 {
	status = "okay";
	pinctrl-0 = <&pwm3_gpio026>;
	pinctrl-names = "default";
};
