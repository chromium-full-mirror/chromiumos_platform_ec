/* Copyright 2026 The ChromiumOS Authors
 * Use of this source code is governed by a BSD-style license that can be
 * found in the LICENSE file.
 */

/ {
    batteries {
		default_battery: celxpert-p360644 {
			compatible = "celxpert,p360644", "battery-smart";
		};
	};
};
