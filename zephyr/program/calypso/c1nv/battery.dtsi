/* Copyright 2026 The ChromiumOS Authors
 * Use of this source code is governed by a BSD-style license that can be
 * found in the LICENSE file.
 */

/ {
	batteries {
		default_battery: swd_swd {
			compatible = "swd,swd", "battery-smart";
		};
		swd_swd_1 {
			compatible = "swd,swd-1", "battery-smart";
		};
	};
};
