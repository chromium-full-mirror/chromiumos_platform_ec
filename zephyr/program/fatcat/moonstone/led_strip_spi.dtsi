/* Copyright 2025 The ChromiumOS Authors
 * Use of this source code is governed by a BSD-style license that can be
 * found in the LICENSE file.
 */

#include <zephyr/dt-bindings/gpio/gpio.h>
#include <zephyr/dt-bindings/led/led.h>

&spi0 {
	spi0_dev0: spi0_dev@0 {
		compatible = "worldsemi,ws2812-spi";
		color-mapping = <LED_COLOR_ID_RED
				 LED_COLOR_ID_GREEN
				 LED_COLOR_ID_BLUE>;
	};
};

&led_pins2 {
	default-brightness-percent = <60>;
	min-brightness-percent = <4>;
	max-power-constrained-white-rgb = <0x1A1E1F>;
	enable-gpios = <&gpiog 1 GPIO_ACTIVE_HIGH>;
	ramp-up-delay-ms = <3>;
};
