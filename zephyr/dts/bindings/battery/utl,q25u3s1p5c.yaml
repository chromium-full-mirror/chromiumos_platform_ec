## zephyr/test/bluey/testcase.yaml
```yaml
# Copyright 2026 The ChromiumOS Authors
# Use of this source code is governed by a BSD-style license that can be
# found in the LICENSE file.

common:
  platform_allow:
    - native_sim
tests:
  bluey.baseboard:
    extra_configs:
      - CONFIG_TEST_BOARD_BASEBOARD=y
      - CONFIG_TEST_BOARD_BASEBOARD_BATTERY=y
      - CONFIG_TEST_BOARD_BASEBOARD_SWITCHCAP=y
      - CONFIG_TEST_BOARD_BASEBOARD_CHIPSET=y
      - CONFIG_TEST_BOARD_BASEBOARD_THROTTLE=y
    extra_dtc_overlay_files:
      - "boards/native_sim.overlay"
  bluey.bluey:
    extra_configs:
      - CONFIG_TEST_BOARD_BLUEY=y
      - CONFIG_TEST_BOARD_BLUEY_CHIPSET=y
      - CONFIG_TEST_BOARD_BLUEY_FAN=y
    extra_dtc_overlay_files:
      - "boards/bluey.overlay"
  bluey.quenbi:
    extra_configs:
      - CONFIG_TEST_BOARD_QUENBI=y
      - CONFIG_TEST_BOARD_QUENBI_CHIPSET=y
      - CONFIG_TEST_BOARD_QUENBI_FAN=y
    extra_dtc_overlay_files:
      - "boards/quenbi.overlay"
  bluey.mica:
    extra_configs:
      - CONFIG_TEST_BOARD_MICA=y
      - CONFIG_TEST_BOARD_MICA_CHIPSET=y
      - CONFIG_TEST_BOARD_MICA_EXTPOWER=y
      - CONFIG_TEST_BOARD_MICA_FAN=y
      - CONFIG_TEST_BOARD_MICA_KEYBOARD=y
      - CONFIG_TEST_BOARD_MICA_LED=y
      - CONFIG_TEST_BOARD_MICA_THROTTLE=y
      - CONFIG_PLATFORM_EC_TEMP_SENSOR=y
    extra_dtc_overlay_files:
      - "boards/mica.overlay"
  bluey.quartz:
    extra_configs:
      - CONFIG_TEST_BOARD_QUARTZ=y
      - CONFIG_TEST_BOARD_QUARTZ_CHIPSET=y
      - CONFIG_TEST_BOARD_QUARTZ_EXTPOWER=y
      - CONFIG_TEST_BOARD_QUARTZ_FAN=y
      - CONFIG_TEST_BOARD_QUARTZ_LED=y
      - CONFIG_PLATFORM_EC_TEMP_SENSOR=y
    extra_dtc_overlay_files:
      - "boards/quartz.overlay"
```

## zephyr/test/bt_passthru/testcase.yaml
```yaml
tests:
  bt_passthru.subsys:
    extra_dtc_overlay_files:
      - boards/native_sim.overlay
    platform_allow:
      - native_sim
```

## zephyr/test/charger/Kconfig
```kconfig
# Copyright 2024 The ChromiumOS Authors
# Use of this source code is governed by a BSD-style license that can be
# found in the LICENSE file.

# Programs
config TEST_PROGRAM_BROX
	bool

config TEST_PROGRAM_NISSA
	bool

choice TEST_BOARD_VARIANT
	prompt "Board variant for tests"

	# Brox variants
	config TEST_BOARD_BROX
		bool "Run brox tests"
		select TEST_PROGRAM_BROX
		select TEST_ISL923X

	# Nissa variants
	config TEST_BOARD_CRAASK
		bool "Run craask tests"
		select TEST_PROGRAM_NISSA
		select TEST_ISL923X
		select TEST_CHARGER_MULTI_DEF

	config TEST_BOARD_CRAASKOV
		bool "Run craaskov tests"
		select TEST_PROGRAM_NISSA
		select TEST_ISL923X
		select TEST_CHARGER_MULTI_DEF

	config TEST_BOARD_NISSA_RAA489000
		bool "Run nissa RAA489000 charger tests"
		select TEST_PROGRAM_NISSA
		select TEST_ISL923X
		select TEST_CHARGER_MULTI_DEF

	config TEST_BOARD_PUJJO
		bool "Run pujjo tests"
		select TEST_PROGRAM_NISSA
		select TEST_ISL923X
		select TEST_CHARGER_SOLO_DEF

	config TEST_BOARD_NATIVE_SIM
		bool "native sim test"

endchoice # TEST_BOARD_VARIANT

config TEST_PROGRAM_NAME
	string
	default "brox" if TEST_PROGRAM_BROX
	default "nissa" if TEST_PROGRAM_NISSA

config TEST_BOARD_NAME
	string
	default "brox" if TEST_BOARD_BROX
	default "craask" if TEST_BOARD_CRAASK
	default "craaskov" if TEST_BOARD_CRAASKOV
	default "pujjo" if TEST_BOARD_PUJJO

# Charger selection
config TEST_ISL923X
	bool
	select ISL923X_MOCK

# Test Selection
choice TEST_TARGET
	prompt "Test to run"
	optional

	config TEST_EXTPOWER
		bool "Run external power tests"
endchoice # TEST_TARGET

config TEST_CHARGER_SOLO_DEF
	bool
	help
	  Define CHARGER_SOLO

config TEST_CHARGER_MULTI_DEF
	bool
	help
	  Define CHARGER_PRIMARY and CHARGER_SECONDARY

config LINK_TEST_SUITE_CHARGE
	bool "Link and test charge files"

config TEST_CHARGE_ACOKREF
	bool "Test charge_acokref.c"

config TEST_CHARGE_MANAGER
	bool "Test charge_manager.c"

config TEST_CHARGE_RAMP
	bool "Test charge_ramp.c"

config TEST_CHARGE_STATE
	bool "Test charge_state.c"

config TEST_CHARGE_STATE_PREVENT_POWER_ON
	bool "Test charge_state.c prevent power on"

config TEST_CHARGE_MANAGER_SEEDING
	bool "Test charge_manager.c seeding"

source "Kconfig.zephyr"
```

## zephyr/test/console/testcase.yaml
```yaml
common:
  platform_allow:
  - native_sim
tests:
  # The UART API provides both interrupt driven and modes.
  console.output.interrupt:
    extra_conf_files:
    - console_output.conf
    extra_dtc_overlay_files:
    - boards/native_sim.overlay
    - console_output.dts
    extra_configs:
    - CONFIG_TEST_CONSOLE_OUTPUT=y
    - CONFIG_SHELL_BACKEND_SERIAL_API_INTERRUPT_DRIVEN=y
    - CONFIG_SHELL_BACKEND_SERIAL_API_POLLING=n
  console.output.interrupt.noisr:
    extra_conf_files:
    - console_output.conf
    extra_dtc_overlay_files:
    - boards/native_sim.overlay
    - console_output.dts
    extra_configs:
    - CONFIG_TEST_CONSOLE_OUTPUT=y
    - CONFIG_SHELL_BACKEND_SERIAL_API_INTERRUPT_DRIVEN=y
    - CONFIG_SHELL_BACKEND_SERIAL_API_POLLING=n
    - CONFIG_PLATFORM_EC_ISR_CONSOLE_OUTPUT=n
  console.output.polling:
    extra_conf_files:
    - console_output.conf
    extra_dtc_overlay_files:
    - boards/native_sim.overlay
    - console_output.dts
    extra_configs:
    - CONFIG_TEST_CONSOLE_OUTPUT=y
    - CONFIG_UART_ASYNC_API=y
    - CONFIG_SHELL_BACKEND_SERIAL_API_INTERRUPT_DRIVEN=n
    - CONFIG_SHELL_BACKEND_SERIAL_API_POLLING=y
  console.output.polling.noisr:
    extra_conf_files:
    - console_output.conf
    extra_dtc_overlay_files:
    - boards/native_sim.overlay
    - console_output.dts
    extra_configs:
    - CONFIG_TEST_CONSOLE_OUTPUT=y
    - CONFIG_UART_ASYNC_API=y
    - CONFIG_SHELL_BACKEND_SERIAL_API_INTERRUPT_DRIVEN=n
    - CONFIG_SHELL_BACKEND_SERIAL_API_POLLING=y
    - CONFIG_PLATFORM_EC_ISR_CONSOLE_OUTPUT=n
  console.restricted:
    extra_configs:
    - CONFIG_TEST_CONSOLE_RESTRICTED=y
    - CONFIG_BOARD_FINGERPRINT=y
  console.output.start_shell_task:
    extra_conf_files:
    - console_output.conf
    extra_dtc_overlay_files:
    - boards/native_sim.overlay
    - console_output.dts
    extra_configs:
    - CONFIG_TEST_CONSOLE_OUTPUT=y
    - CONFIG_SHELL_BACKEND_SERIAL_API_INTERRUPT_DRIVEN=y
    - CONFIG_SHELL_BACKEND_SERIAL_API_POLLING=n
    - CONFIG_PLATFORM_EC_CONSOLE_START_SHELL_TASK=y
  console.pw_log_tokenized:
    extra_configs:
    - CONFIG_TEST_PW_LOG_TOKENIZED=y
    - CONFIG_PIGWEED_LOG_TOKENIZED_LIB=y
    - CONFIG_CPP=y
    - CONFIG_STD_CPP20=y
    - CONFIG_REQUIRES_FULL_LIBCPP=y
    - CONFIG_PLATFORM_EC_HOSTCMD_CONSOLE_DROPPED_LOGS=y
    - CONFIG_PLATFORM_EC_HOSTCMD_CONSOLE=y
    - CONFIG_PLATFORM_EC_PANIC_LOG=y
    - CONFIG_ZTEST_FATAL_HOOK=y
    - CONFIG_CLEANUP_INTERMEDIATE_FILES=n
```
