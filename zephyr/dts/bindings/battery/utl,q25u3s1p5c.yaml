## zephyr/dts/bindings/battery/utl,q25u3s1p5c.yaml
```yaml
# Copyright 2026 The ChromiumOS Authors
# Use of this source code is governed by a BSD-style license that can be
# found in the LICENSE file.

description: "UTL,Q25U3S1P5C"
compatible: "utl,q25u3s1p5c"

include: battery-smart.yaml

properties:
  enum-name:
    type: string
    default: "utl,q25u3s1p5c"

  # Fuel gauge
  manuf_name:
    default: "UTL"
  device_name:
    default: "Q25U3S1P5C"
  ship_mode_reg_addr:
    default: 0x00
  ship_mode_reg_data:
    default: [0x0010, 0x0010]
  flags:
    default: 0x04
  fet_reg_addr:
    default: 0x0054
  fet_reg_mask:
    default: 0x0002
  fet_disconnect_val:
    default: 0x0000
  fet_cfet_mask:
    default: 0x0004
  fet_cfet_off_val:
    default: 0x0000

  # Battery info
  voltage_max:
    default: 13500
  voltage_normal:
    default: 11730
  voltage_min:
    default: 9000
  precharge_current:
    default: 226
  start_charging_min_c:
    default: 0
  start_charging_max_c:
    default: 45
  charging_min_c:
    default: 0
  charging_max_c:
    default: 60
  discharging_min_c:
    default: -20
  discharging_max_c:
    default: 60
```

## zephyr/dts/bindings/fingerprint/egis,egis660.yaml
```yaml
# Copyright 2026 The Chromium OS Authors. All rights reserved.
# Use of this source code is governed by a BSD-style license that can be
# found in the LICENSE file.

description: EGIS660 fingerprint sensor

compatible: "egis,egis660"

include: [spi-device.yaml]

properties:
  irq-gpios:
    type: phandle-array
    required: true
    description: |
      This property specifies the connection for sensor interrupt.

  reset-gpios:
    type: phandle-array
    required: true
    description: |
      This property specifies the connection for sensor reset.

  cover-type:
    type: string
    required: false
    default: "glass"
    enum:
      - "glass"
      - "spray-coating"
    description: |
      The cover type of the fingerprint sensor. Different cover types
      require different private libraries.
```

## zephyr/dts/bindings/fingerprint/elan.elanhv515rc.yaml
```yaml
# Copyright 2026 The ChromiumOS Authors.
# Use of this source code is governed by a BSD-style license that can be
# found in the LICENSE file.

description: ELANHV515RC fingerprint sensor

compatible: "elan,elanhv515rc"

include: [spi-device.yaml]

properties:
  irq-gpios:
    type: phandle-array
    required: true
    description: |
      This property specifies the connection for sensor interrupt.

  reset-gpios:
    type: phandle-array
    required: true
    description: |
      This property specifies the connection for sensor reset.

  base-image:
    type: phandle
    description: |
      Phandle to a partition storing the fingerprint sensor's base image.

  ft-info:
    type: phandle
    description: |
      Phandle to a partition with the Factory Test information.
```

## zephyr/dts/bindings/input/cros-ec,power-button-keyboard.yaml
```yaml
# Copyright 2026 The ChromiumOS Authors
# Use of this source code is governed by a BSD-style license that can be
# found in the LICENSE file.

description: |
  Keyboard-matrix power button suppression configuration.

compatible: "cros-ec,power-button-keyboard"

include: base.yaml

properties:
  suppress-enable-pin:
    type: phandle
    required: true
    description: |
      GPIO node (in named-gpios) that gates power button suppression in S0
      tablet mode (e.g. the eDP backlight enable signal). Power button
      presses are only suppressed in S0 tablet mode when this signal is
      asserted, allowing the power button to wake the display when the
      screen is off in S0.
```

## zephyr/dts/bindings/power/cros-ec,ap-power-events.yaml
```yaml
# Copyright 2026 The ChromiumOS Authors
# Use of this source code is governed by a BSD-style license that can be
# found in the LICENSE file.

description: |
  Driver to control GPIOs based on AP power state.
  GPIOs are asserted (set active) on AP POWER_STARTUP / POWER_PRE_INIT
  and de-asserted (set inactive) on AP POWER_HARD_OFF.

compatible: "cros-ec,ap-power-events"

properties:
  event-gpios:
    type: phandle-array
    required: true
    description: |
      List of GPIO phandles with flags. These GPIOs are asserted
      (set active) on POWER_STARTUP and de-asserted (set inactive) on
      POWER_HARD_OFF.
```

## zephyr/dts/bindings/pwrmon/pwrmon.yaml
```yaml
description: EC Power Monitoring subsystem

compatible: "cros,pwrmon"

include: [base.yaml]

properties:
  sample-rate:
    type: int
    required: true
    description: Default sampling rate in Hz

  power-monitors:
    type: phandles
    required: true
    description: List of phandles pointing to power monitors sensors

  gpios:
    type: phandle-array
    description: GPIO used to control the I2C between EC and GSC
```

## zephyr/dts/bindings/qcom-ap-pwrseq/cros-ec,qcom-ap-pwrseq.yaml
```yaml
# Copyright 2026 The ChromiumOS Authors
# Use of this source code is governed by a BSD-style license that can be
# found in the LICENSE file.

description: Qualcomm AP Power Sequence Driver

compatible: "cros-ec,qcom-ap-pwrseq"

properties:
  switchcap:
    type: phandle
    required: true
    description: Switchcap device driver.

  ap-rst-gpios:
    type: phandle-array
    required: true
    description: Input GPIO indicating AP reset state.

  ap-suspend-gpios:
    type: phandle-array
    required: true
    description: Input GPIO indicating AP suspend state.

  power-good-gpios:
    type: phandle-array
    required: true
    description: |
      Input GPIO indicating motherboard power good state.

  pmic-kpd-pwr-odl-gpios:
    type: phandle-array
    required: true
    description: |
      Output open-drain GPIO to PMIC power key signal.

  pmic-resin-gpios:
    type: phandle-array
    required: true
    description: |
      Output open-drain GPIO to PMIC reset signal.
```

## zephyr/dts/bindings/switchcap/cros-ec,switchcap.yaml
```yaml
# Copyright 2026 The ChromiumOS Authors
# Use of this source code is governed by a BSD-style license that can be
# found in the LICENSE file.

description: ChromiumOS Switchcap Driver controlled by GPIOs

compatible: "cros-ec,switchcap"

properties:
  enable-gpios:
    type: phandle-array
    required: true
    description: Output GPIO used to enable the switchcap.

  power-good-gpios:
    type: phandle-array
    required: true
    description: Input GPIO used to read switchcap power-good status.

  power-off-delay-ms:
    type: int
    description: Additional power-off delay in milliseconds.
```

## zephyr/dts/bindings/throttle/cros-ec,ap-throttle.yaml
```yaml
# Copyright 2026 The ChromiumOS Authors
# Use of this source code is governed by a BSD-style license that can be
# found in the LICENSE file.

description: GPIO-based AP power/thermal throttling driver

compatible: "cros-ec,ap-throttle"

include: base.yaml

properties:
  throttle-gpios:
    type: phandle-array
    required: true
    description: |
      GPIO pin connected to the AP throttle / PROCHOT signal (e.g.,
      EC_SYS_THROTTLE_MIRA or EC_SYS_THROTTLE_MIRA_ODL). Active level is
      determined by GPIO_ACTIVE_HIGH / GPIO_ACTIVE_LOW flags.
  ac-only-boot-throttle:
    type: boolean
    description: |
      Keep the throttle signal asserted throughout boot/S0 when booting on AC
      power without a battery present (battery_is_present() != BP_YES).
```

## zephyr/dts/bindings/usbc/cros-ec,pdc-dp-alt-mode.yaml
```yaml
# Copyright 2026 The ChromiumOS Authors
# Use of this source code is governed by a BSD-style license that can be
# found in the LICENSE file.

description: |
  ChromiumOS PDC DisplayPort Alt-Mode HPD and AUX mux driver.

  This driver registers PDC DP_ATTENTION and UNATTACH callbacks to arbitrate
  DisplayPort Alt-Mode entry across USB-C ports using a first-come,
  first-served (FCFS) policy, driving a single AP HPD GPIO and an optional
  AUX path select GPIO. It should only be used for APs that have a single
  DisplayPort path shared across one or more USB-C ports.

compatible: "cros-ec,pdc-dp-alt-mode"

include: base.yaml

properties:
  hpd-gpios:
    type: phandle-array
    required: true
    description: Output GPIO driving DisplayPort HPD to the AP.

  aux-path-sel-gpios:
    type: phandle-array
    description:
      Optional output GPIO selecting the DisplayPort AUX path between USB-C
      ports (0 for port 0, 1 for port 1).
```

## zephyr/program/ec-aic/Kconfig
```kconfig
# Copyright 2025 The ChromiumOS Authors
# Use of this source code is governed by a BSD-style license that can be
# found in the LICENSE file.

config BOARD_ITE_AIC
	bool "Google ITE AIC board"
	help
	  Build Google AIC image for the ITE chipset.

config BOARD_NPCX_AIC
	bool "Google NPCX AIC board"
	help
	  Build Google AIC image for the NPCX9 chipset.

config BOARD_RTK_AIC
	bool "Google RTK AIC board"
	help
	  Build Google AIC image for the Realtek chipset.

module = EC_AIC
module-str = EC-AIC board-specific code
source "subsys/logging/Kconfig.template.log_config"

choice PLATFORM_EC_USBC_STACK
	default PLATFORM_EC_USB_PD_CONTROLLER
endchoice

source "Kconfig.zephyr"
```

## zephyr/subsys/bt_passthru/Kconfig
```kconfig
# Copyright 2026 The ChromiumOS Authors
# Use of this source code is governed by a BSD-style license that can be
# found in the LICENSE file.

menuconfig BT_PASSTHRU
	bool "Enable Bluetooth passthrough"
	help
	  Enable Bluetooth passthrough host commands to route HCI data
	  between the AP and the BT Controller.

if BT_PASSTHRU

module = BT_PASSTHRU
module-str = BT Passthru
source "subsys/logging/Kconfig.template.log_config"

config BT_PASSTHRU_SENDER
	def_bool y
	select BT
	select BT_HCI_RAW

config BT_PASSTHRU_HOST_TRANSPORT
	def_bool y
	select PIGWEED_SPAN
	select PIGWEED_STATUS
	select PIGWEED_FUNCTION

# Default buffer sizes to support HCI Command routing
config BT_BUF_CMD_TX_SIZE
	default 255

config BT_BUF_EVT_RX_SIZE
	default 255

config BT_BUF_EVT_RX_COUNT
	default 16

config BT_BUF_ACL_TX_COUNT
	default 3

config BT_BUF_ACL_TX_SIZE
	default 251

config BT_BUF_ACL_RX_SIZE
	default 255

config BT_MAX_CONN
	default 16

config BT_PASSTHRU_INIT_PRIORITY
	int "BT passthru stack init priority"
	default 91
	help
	  Initialization priority of the BT passthrough subsystem during the
	  POST_KERNEL phase. This should occur after the physical Bluetooth
	  HCI hardware drivers are initialized.

config BT_PASSTHRU_THREAD_PRIORITY
	int "BT passthru RX thread priority"
	default 5
	help
	  Set the priority of the dedicated BT passthrough RX thread.
	  Note: If this thread handles time-sensitive HCI events, consider
	  a higher (lower number) priority.

config BT_PASSTHRU_STACK_SIZE
	int "BT passthru thread stack size"
	default 2048
	help
	  Size of the stack assigned to the BT passthrough RX thread.
	  The thread handles incoming HCI packets and routes them to
	  the Host Transport ring buffer.

endif # BT_PASSTHRU
```

## zephyr/subsys/qcom_ap_pwrseq/Kconfig
```kconfig
# Copyright 2026 The ChromiumOS Authors
# Use of this source code is governed by a BSD-style license that can be
# found in the LICENSE file.

config QCOM_AP_PWRSEQ_DRIVER
	bool "Qualcomm AP power sequencing driver"
	default y
	depends on DT_HAS_CROS_EC_QCOM_AP_PWRSEQ_ENABLED
	select AP_POWER_CONTROL if PLATFORM_EC
	help
	  Enables the AP power sequence driver for Qualcomm chipsets.

if QCOM_AP_PWRSEQ_DRIVER

config QCOM_AP_PWRSEQ_STACK_SIZE
	int "Qualcomm AP power sequencing thread stack size (in bytes)"
	default 1536
	help
	  Set stack size of the Qualcomm AP power sequencer thread.

config QCOM_AP_PWRSEQ_THREAD_PRIORITY
	int "Qualcomm AP power sequencing thread priority"
	default 5
	help
	  Set thread priority of the Qualcomm AP power sequencer.

endif # QCOM_AP_PWRSEQ_DRIVER
```

## zephyr/test/bklight_passthru/testcase.yaml
```yaml
common:
  platform_allow:
    - native_sim
tests:
  bklight_passthru.default: {}
```

## zephyr/test/bluey/Kconfig
```kconfig
# Copyright 2026 The ChromiumOS Authors
# Use of this source code is governed by a BSD-style license that can be
# found in the LICENSE file.

config TEST_DISABLE_INLINE_CHIPSET_IN_STATE
	bool "Disable chipset_in_state inline method"
	default y

choice TEST_BOARD_VARIANT
	prompt "Select board variant for tests"
	help
	  Board variant to use for tests

	config TEST_BOARD_BASEBOARD
		bool "Enable baseboard-specific tests"
		help
		  Enable Bluey baseboard tests.

	config TEST_BOARD_BLUEY
		bool "Enable bluey-specific tests"
		help
		  Enable Bluey tests.

	config TEST_BOARD_QUENBI
		bool "Enable quenbi-specific tests"
		help
		  Enable Quenbi tests.

	config TEST_BOARD_MICA
		bool "Enable mica-specific tests"
		help
		  Enable Mica tests.

	config TEST_BOARD_QUARTZ
		bool "Enable quartz-specific tests"
		help
		  Enable Quartz tests.

	config TEST_BOARD_ANNITE
		bool "Enable annite-specific tests"
		help
		  Enable Annite tests.

	config TEST_BOARD_PIC
		bool "Enable pic-specific tests"
		help
		  Enable Pic tests.

endchoice # TEST_BOARD_VARIANT

config TEST_BOARD_NAME
	string "Board name"
	default "baseboard" if TEST_BOARD_BASEBOARD
	default "bluey" if TEST_BOARD_BLUEY
	default "quenbi" if TEST_BOARD_QUENBI
	default "mica" if TEST_BOARD_MICA
	default "quartz" if TEST_BOARD_QUARTZ
	default "annite" if TEST_BOARD_ANNITE
	default "pic" if TEST_BOARD_PIC

config TEST_BOARD_BASEBOARD_BATTERY
	bool "Enable baseboard battery tests"

config TEST_BOARD_BASEBOARD_SWITCHCAP
	bool "Enable baseboard switchcap tests"

config TEST_BOARD_BASEBOARD_CHIPSET
	bool "Enable baseboard chipset tests"

config TEST_BOARD_BASEBOARD_THROTTLE
	bool "Enable baseboard throttle tests"

config TEST_BOARD_BLUEY_CHIPSET
	bool "Enable bluey chipset tests"

config TEST_BOARD_BLUEY_FAN
	bool "Enable bluey fan tests"

config TEST_BOARD_QUENBI_CHIPSET
	bool "Enable quenbi chipset tests"

config TEST_BOARD_QUENBI_FAN
	bool "Enable quenbi fan tests"

config TEST_BOARD_MICA_CHIPSET
	bool "Enable mica chipset tests"

config TEST_BOARD_MICA_EXTPOWER
	bool "Enable mica extpower tests"

config TEST_BOARD_MICA_FAN
	bool "Enable mica fan tests"

config TEST_BOARD_MICA_KEYBOARD
	bool "Enable mica keyboard tests"

config TEST_BOARD_MICA_LED
	bool "Enable mica led tests"

config TEST_BOARD_MICA_THROTTLE
	bool "Enable mica throttle tests"

config TEST_BOARD_QUARTZ_CHIPSET
	bool "Enable quartz chipset tests"

config TEST_BOARD_QUARTZ_EXTPOWER
	bool "Enable quartz extpower tests"

config TEST_BOARD_QUARTZ_FAN
	bool "Enable quartz fan tests"

config TEST_BOARD_QUARTZ_LED
	bool "Enable quartz led tests"

config TEST_BOARD_ANNITE_CHIPSET
	bool "Enable annite chipset tests"

config TEST_BOARD_ANNITE_EXTPOWER
	bool "Enable annite extpower tests"

config TEST_BOARD_ANNITE_FAN
	bool "Enable annite fan tests"

config TEST_BOARD_ANNITE_THROTTLE
	bool "Enable annite throttle tests"

config TEST_BOARD_PIC_CHIPSET
	bool "Enable pic chipset tests"

config TEST_BOARD_PIC_EXTPOWER
	bool "Enable pic extpower tests"

config TEST_BOARD_PIC_FAN
	bool "Enable pic fan tests"

config TEST_BOARD_PIC_THROTTLE
	bool "Enable pic throttle tests"

source "Kconfig.zephyr"
```
